## drivers/platform/Kconfig
```kconfig
# drivers/platform/Kconfig

if X86
source "drivers/platform/x86/Kconfig"
endif
if GOLDFISH
source "drivers/platform/goldfish/Kconfig"
endif

if ARM
source "drivers/platform/arm/Kconfig"
endif

config CHROMEOS
	bool
	depends on ARM_CHROMEOS_FIRMWARE || (NVRAM && ACPI_CHROMEOS)

	---help---
	  Provides abstracted interfaces to the firmware features provided on
	  ChromeOS devices. It depends on a lowlevel driver to implement the
	  firmware interface on the platform.

config CHROMEOS_VBC_BLK
	bool
	depends on CHROMEOS

	---help---
	  Provides access to vboot context stored on block device.  Select this
	  if you have a ChromeOS firmware that does not support storing vboot
	  context in EC's nvram.

config CHROMEOS_VBC_EC
	bool
	depends on CHROMEOS && MFD_CROS_EC

	---help---
	  Provides access to vboot context stored on EC's nvram.  Select this
	  if you have a ChromeOS firmware that supports storing vboot context
	  in EC's nvram.

config CHROMEOS_RAMOOPS_RAM_START
        hex "Physical address of preserved RAM"
	depends on PSTORE_RAM && CHROMEOS
        default "0"

        ---help---
          Address of the memory area that is used for logging using ramoops.
	  This value can also be set through platform data.

          For this feature to be useful, the selected memory area must be
          preserved across reboot, so not used by the boot loader, for example.

config CHROMEOS_RAMOOPS_RAM_SIZE
        hex "Size of preserved RAM"
	depends on PSTORE_RAM && CHROMEOS
        default "0"

        ---help---
          Size of the memory area that is used for logging using ramoops.
	  This value can also be set through platform data.

          For this feature to be useful, the selected memory area must be
          preserved across reboot, so not used by the boot loader, for example.

config CHROMEOS_RAMOOPS_RECORD_SIZE
        hex "Size of a single dump logged in RAM"
	depends on PSTORE_RAM && CHROMEOS
        default "0x00001000"

        ---help---
          This is the size of a single dump which is logged in RAM. Should be
	  set according to the level of detail needed in the dump.
	  This value can also be set through platform data.

	  Must be divisible by CHROMEOS_RAMOOPS_RAM_SIZE.

config CHROMEOS_RAMOOPS_DUMP_OOPS
        hex "Flag to dump oopses and panics or only panics"
	depends on PSTORE_RAM && CHROMEOS
        default "1"

        ---help---
	  If flag is set to 0 dump oopses and panics.
	  If flag is set to 1 dump only panics.

	  This value can also be set through platform data.
          For this feature to be useful, the selected memory area must be
          preserved across reboot, so not used by the boot loader, for example.
```

## drivers/platform/x86/intel_dptf/Kconfig
```kconfig
#
# DPTF Drivers
#

config INTEL_DPTF
	tristate "Intel DPTF/ESIF Lower Framework"
	select IOSF_MBI
	depends on ACPI
	---help---
	  This is a driver for DPTF/ESIF Lower Framework.

config INTEL_DPTF_ACPI
	tristate "Intel DPTF Acpi Participant"
	depends on INTEL_DPTF
	---help---
	  This is a driver for DPTF Acpi Participant.

config INTEL_DPTF_CPU
	tristate "Intel DPTF CPU Participant"
	depends on INTEL_DPTF
	---help---
	  This is a driver for DPTF CPU Participant.

config INTEL_DPTF_PCH
	tristate "Intel DPTF PCH Participant"
	depends on INTEL_DPTF
	---help---
	  This is a driver for DPTF PCH Participant.
```

## drivers/thermal/Kconfig
```kconfig
#
# Generic thermal sysfs drivers configuration
#

menuconfig THERMAL
	tristate "Generic Thermal sysfs driver"
	help
	  Generic Thermal Sysfs driver offers a generic mechanism for
	  thermal management. Usually it's made up of one or more thermal
	  zone and cooling device.
	  Each thermal zone contains its own temperature, trip points,
	  cooling devices.
	  All platforms with ACPI thermal support can use this driver.
	  If you want this support, you should say Y or M here.

if THERMAL

config THERMAL_HWMON
	bool
	prompt "Expose thermal sensors as hwmon device"
	depends on HWMON=y || HWMON=THERMAL
	default y
	help
	  In case a sensor is registered with the thermal
	  framework, this option will also register it
	  as a hwmon. The sensor will then have the common
	  hwmon sysfs interface.

	  Say 'Y' here if you want all thermal sensors to
	  have hwmon sysfs interface too.

config THERMAL_OF
	bool
	prompt "APIs to parse thermal data out of device tree"
	depends on OF
	default y
	help
	  This options provides helpers to add the support to
	  read and parse thermal data definitions out of the
	  device tree blob.

	  Say 'Y' here if you need to build thermal infrastructure
	  based on device tree.

choice
	prompt "Default Thermal governor"
	default THERMAL_DEFAULT_GOV_STEP_WISE
	help
	  This option sets which thermal governor shall be loaded at
	  startup. If in doubt, select 'step_wise'.

config THERMAL_DEFAULT_GOV_STEP_WISE
	bool "step_wise"
	select THERMAL_GOV_STEP_WISE
	help
	  Use the step_wise governor as default. This throttles the
	  devices one step at a time.

config THERMAL_DEFAULT_GOV_FAIR_SHARE
	bool "fair_share"
	select THERMAL_GOV_FAIR_SHARE
	help
	  Use the fair_share governor as default. This throttles the
	  devices based on their 'contribution' to a zone. The
	  contribution should be provided through platform data.

config THERMAL_DEFAULT_GOV_USER_SPACE
	bool "user_space"
	select THERMAL_GOV_USER_SPACE
	help
	  Select this if you want to let the user space manage the
	  lpatform thermals.

endchoice

config THERMAL_GOV_FAIR_SHARE
	bool "Fair-share thermal governor"
	help
	  Enable this to manage platform thermals using fair-share governor.

config THERMAL_GOV_STEP_WISE
	bool "Step_wise thermal governor"
	help
	  Enable this to manage platform thermals using a simple linear

config THERMAL_GOV_USER_SPACE
	bool "User_space thermal governor"
	help
	  Enable this to let the user space manage the platform thermals.

config THERMAL_GOV_PID
	bool
	prompt "PID thermal governor"
	depends on THERMAL
	help
	  This governor manages thermals based on output values of
	  PID controller.

config CPU_THERMAL
	bool "generic cpu cooling support"
	depends on CPU_FREQ
	select CPU_FREQ_TABLE
	help
	  This implements the generic cpu cooling mechanism through frequency
	  reduction. An ACPI version of this already exists
	  (drivers/acpi/processor_thermal.c).
	  This will be useful for platforms using the generic thermal interface
	  and not the ACPI interface.

	  If you want this support, you should say Y here.

config THERMAL_EMULATION
	bool "Thermal emulation mode support"
	help
	  Enable this option to make a emul_temp sysfs node in thermal zone
	  directory to support temperature emulation. With emulation sysfs node,
	  user can manually input temperature and test the different trip
	  threshold behaviour for simulation purpose.

	  WARNING: Be careful while enabling this option on production systems,
	  because userland can easily disable the thermal policy by simply
	  flooding this sysfs node with low temperature values.

config SPEAR_THERMAL
	bool "SPEAr thermal sensor driver"
	depends on PLAT_SPEAR
	depends on OF
	help
	  Enable this to plug the SPEAr thermal sensor driver into the Linux
	  thermal framework

config RCAR_THERMAL
	tristate "Renesas R-Car thermal driver"
	depends on ARCH_SHMOBILE
	help
	  Enable this to plug the R-Car thermal sensor driver into the Linux
	  thermal framework

config KIRKWOOD_THERMAL
	tristate "Temperature sensor on Marvell Kirkwood SoCs"
	depends on ARCH_KIRKWOOD
	depends on OF
	help
	  Support for the Kirkwood thermal sensor driver into the Linux thermal
	  framework. Only kirkwood 88F6282 and 88F6283 have this sensor.

config EXYNOS_THERMAL
	tristate "Temperature sensor on Samsung EXYNOS"
	depends on (ARCH_EXYNOS4 || ARCH_EXYNOS5)
	depends on CPU_THERMAL
	help
	  If you say yes here you get support for TMU (Thermal Management
	  Unit) on SAMSUNG EXYNOS series of SoC.

config DOVE_THERMAL
	tristate "Temperature sensor on Marvell Dove SoCs"
	depends on ARCH_DOVE
	depends on OF
	help
	  Support for the Dove thermal sensor driver in the Linux thermal
	  framework.

config DB8500_THERMAL
	bool "DB8500 thermal management"
	depends on ARCH_U8500
	default y
	help
	  Adds DB8500 thermal management implementation according to the thermal
	  management framework. A thermal zone with several trip points will be
	  created. Cooling devices can be bound to the trip points to cool this
	  thermal zone if trip points reached.

config ARMADA_THERMAL
	tristate "Armada 370/XP thermal management"
	depends on ARCH_MVEBU
	depends on OF
	help
	  Enable this option if you want to have support for thermal management
	  controller present in Armada 370 and Armada XP SoC.

config DB8500_CPUFREQ_COOLING
	tristate "DB8500 cpufreq cooling"
	depends on ARCH_U8500
	depends on CPU_THERMAL
	default y
	help
	  Adds DB8500 cpufreq cooling devices, and these cooling devices can be
	  bound to thermal zone trip points. When a trip point reached, the
	  bound cpufreq cooling device turns active to set CPU frequency low to
	  cool down the CPU.

config INTEL_POWERCLAMP
	tristate "Intel PowerClamp idle injection driver"
	depends on THERMAL
	depends on X86
	depends on CPU_SUP_INTEL
	help
	  Enable this to enable Intel PowerClamp idle injection driver. This
	  enforce idle time which results in more package C-state residency. The
	  user interface is exposed via generic thermal framework.

config TEGRA_SOCTHERM
	bool "Enable Tegra soc_therm"
        depends on (ARCH_TEGRA_114_SOC || ARCH_TEGRA_124_SOC)
        default y
        help
          Enables use of soc_therm for thermal management.

config TEGRA_THERM_EST
	bool "Tegra thermal estimator driver"
	depends on THERMAL_OF
	default n
	help
	  Tegra thermal driver which estimates temperature based
	  off of the weighted sum of a sequence of readings from
	  other sensors. The weights customized on a per-platform
	  basis.

config TEGRA_124_DFLL_COOLING
	tristate "Tegra124 DFLL thermal reaction driver"
	depends on THERMAL && CLK_TEGRA_T124_DFLL
	help
	  Enable this to add the ability to automatically adjust the
	  DFLL's minimum voltage floor, based on the SoC temperature.
	  As the SoC temperature increases, the minimum voltage floor
	  can decrease, reducing energy consumption.

config TEGRA_THERMAL_THROTTLE
	bool "Enable throttling of Tegra CPU speed on overtemp"
	depends on THERMAL
	depends on (ARCH_TEGRA_114_SOC || ARCH_TEGRA_124_SOC)
	default y
	help
	  Enable this to add Tegra thermal governors that alter the
	  CPU/GPU speed and the rates of c3bus, sclk, and emc clocks.
	  This keeps the temperature and performance stable and prevents
	  overheating.

config AS3722_THERMAL
	bool "AMS AS3722 thermal driver"
	depends on THERMAL_OF && MFD_AS3722
	default n
	help
	  AS3722 thermal driver which detects temperature trips
	  on regulators due to high current drainage.It then provides
	  current temp on the regulators using ADC and uses platform
	  cooling hooks to throttle CPU/GPU speeds.

endif
```
