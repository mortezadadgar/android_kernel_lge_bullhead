## drivers/video/tegra/Kconfig
```kconfig
if ARCH_TEGRA

config TEGRA_NVMAP
	bool "Tegra GPU memory management driver (nvmap)"
	select ARM_DMA_USE_IOMMU if IOMMU_API
	select DMA_SHARED_BUFFER
	default y
	help
	  Say Y here to include the memory management driver for the Tegra
	  GPU, multimedia and display subsystems

config NVMAP_HIGHMEM_ONLY
	bool "Use only HIGHMEM for nvmap"
	depends on TEGRA_NVMAP && IOMMU_API && HIGHMEM
	default n
	help
	  Say Y here to restrict nvmap system memory allocations (both
	  physical system memory and IOVMM) to just HIGHMEM pages.

config NVMAP_CARVEOUT_KILLER
	bool "Reclaim nvmap carveout by killing processes"
	depends on TEGRA_NVMAP
	default n
	help
	  Say Y here to allow the system to reclaim carveout space by killing
	  processes. This will kill the largest consumers of lowest priority
	  first.

config NVMAP_PAGE_POOLS
	bool "Use page pools to reduce allocation overhead"
	depends on TEGRA_NVMAP
	default y
	help
	  say Y here to reduce the alloction overhead, which is significant
	  for uncached, writecombine and inner cacheable memories as it
	  involves changing page attributes during every allocation per page
	  and flushing cache. Alloc time is reduced by allcoating the pages
	  ahead and keeping them aside. The reserved pages would be released
	  when system is low on memory and acquired back during release of
	  memory.

config NVMAP_PAGE_POOLS_INIT_FILLUP
	bool "Fill up page pools during page pools init"
	depends on NVMAP_PAGE_POOLS
	default y
	help
	  Say Y here to fill up the page pools during page pool init time.
	  This helps in faster alloctions right from the early alloction
	  requests. Page pools fill up during init would increase the boot time.
	  If increase in boot time is not acceptable, keep this option disabled.

config NVMAP_PAGE_POOLS_INIT_FILLUP_SIZE
	depends on NVMAP_PAGE_POOLS_INIT_FILLUP
	hex "Amount of memory to fill up page pools with during bootup in MB"
	default 0x64

config NVMAP_PAGE_POOL_SIZE
	depends on NVMAP_PAGE_POOLS
	hex "Page pool size in pages"
	default 0x0

config NVMAP_CACHE_MAINT_BY_SET_WAYS
	bool "Enable cache maintenance by set/ways"
	depends on TEGRA_NVMAP
	help
	 Say Y here to reduce cache maintenance overhead by MVA.
	 This helps in reducing cache maintenance overhead in the systems,
	 where inner cache includes only L1. For the systems, where inner cache
	 includes L1 and L2, keep this option disabled.

config NVMAP_CACHE_MAINT_BY_SET_WAYS_ON_ONE_CPU
	bool "Perform cache maint on one cpu only"
	depends on TEGRA_NVMAP && NVMAP_CACHE_MAINT_BY_SET_WAYS
	help
	  Say Y here to avoid cache maint on all CPU's during inner cache maint
	  by set/ways. When L1 and L2 are inner caches, cache maint on one
	  CPU is enough. When L1 is inner and L2 is outer, cache maint on
	  all CPU's is necessary during L1 cache maint by set/ways.

config NVMAP_OUTER_CACHE_MAINT_BY_SET_WAYS
	bool "Enable outer cache maintenance by set/ways"
	depends on TEGRA_NVMAP
	help
	  Say Y here if you want to optimize cache maintenance for ranges
	  bigger than size of outer cache. This option has no effect on
	  system without outer cache.

config NVMAP_DEFERRED_CACHE_MAINT
	bool "Enable deferred cache maintenance"
	depends on TEGRA_NVMAP
	help
	  Say Y here if you want to defer flush requests for
	  nvmap memory buffer. Cache maintenance of deferred requests
	  is more efficient since there is a high chance that cache lines
	  of earlier requests are already flushed. Also, if total size of
	  deferred ranges is big enough, we flush whole inner or outer
	  cache.

config NVMAP_DMABUF_STASH
	bool "Enable stashing of IOVA maps with dmabuf"
	depends on TEGRA_NVMAP
	default y
	help
	  Set to Y if you would like nvmap to stash maps when using dma
	  bufs. This will speed up remapping of the same handle at the cost
	  of using more IOVA space.

config NVMAP_DMABUF_STASH_STATS
	bool "Enable stat tracking on the stash"
	depends on NVMAP_DMABUF_STASH
	help
	  Say Y to enable tracking of basic cache statistics on the dmabuf
	  stash. This adds some overhead but should be very useful for
	  debugging memory leaks.

config NVMAP_VPR
	bool "Enable VPR Heap."
	depends on TEGRA_NVMAP
	default n
	help
	  Say Y here to enable Video Protection Region(VPR) heap.
	  if unsure, say N.

config NVMAP_FORCE_ZEROED_USER_PAGES
	bool "Only alloc zeroed pages for user space"
	depends on TEGRA_NVMAP
	help
	  Say Y here to force zeroing of pages allocated for user space. This
	  avoids leaking kernel secure data to user space. This can add
	  significant overhead to allocation operations depending on the
	  allocation size requested.

config NVMAP_USE_FD_FOR_HANDLE
	bool "Use Fd's to represent NvMap handles"
	depends on TEGRA_NVMAP
	default y
	help
	  Say Y here to use Fd's for representing NvMap handles
	  in user space. Enabling this config returns DmaBuf
	  compatible Fd's to user space during handle creation
	  requests. The kernel component that receives these Fd's
	  can use either NvMap interface or DmaBuf interface in order
	  to access NvMap handle memory.

config NVMAP_USE_CMA_FOR_CARVEOUT
	bool "Use CMA memory for carveouts"
	depends on TEGRA_NVMAP
	help
	  Say Y here to reserve carveout memory using CMA
	  API. CMA reserved memory can be used by applications
	  when it is not in use by the device that reserved it.

config NVMAP_CPA
	bool "Use CPA API in nvmap"
	depends on CPA
	help
	  Say Y here to have nvmap use CPA. CPA is necessary for
	  certain chips where page table aliasing can cause undefined
	  results due to speculative memory loads/stores. If unsure,
	  say N.

config NVMAP_CONVERT_CARVEOUT_TO_IOVMM
	bool "Convert carveout to IOVMM"
	depends on TEGRA_NVMAP && IOMMU_API
	default y
	help
	  Say Y here to force to convert carveout memory requests to
	  I/O virtual memory requests.

config NVMAP_HANDLE_MARSHAL
	bool "Marshal nvmap handle id"
	depends on TEGRA_NVMAP
	help
	  Enables nvmap handle id marshalling. Marshalling converts
	  the nvmap handle id into an unique number before passing
	  the handle id to user/kernel clients. The marshalling
	  would allow sharing a 64-bit handle id as 32-bit id to
	  user space when kernel is 64-bit and user space is 32-bit.

endif
```

## security/chromiumos/Kconfig
```kconfig
config SECURITY_CHROMIUMOS
	bool "Chromium OS Security Module"
	depends on SECURITY
	help
	  The purpose of the Chromium OS security module is to reduce attacking
	  surface by preventing access to general purpose access modes not
	  required by Chromium OS. Currently: the mount operation is
	  restricted by requiring a mount point path without symbolic links,
	  and loading modules is limited to only the root filesystem.

config SECURITY_CHROMIUMOS_READONLY_PROC_SELF_MEM
	bool "Force /proc/<pid>/mem paths to be read-only"
	default y
	help
	  When enabled, attempts to open /proc/self/mem for write access
	  will always fail.  Write access to this file allows bypassing
	  of memory map permissions (such as modifying read-only code).
```

## sound/pci/hda/Kconfig
```kconfig
menu "HD-Audio"

config SND_HDA
	tristate
	select SND_PCM
	select SND_VMASTER
	select SND_KCTL_JACK

config SND_HDA_INTEL
	tristate "HD Audio PCI"
	depends on SND_PCI
	select SND_HDA
	help
	  Say Y here to include support for Intel "High Definition
	  Audio" (Azalia) and its compatible devices.

	  This option enables the HD-audio controller.  Don't forget
	  to choose the appropriate codec options below.

	  To compile this driver as a module, choose M here: the module
	  will be called snd-hda-intel.

config SND_HDA_TEGRA
	tristate "Tegra HD Audio"
	select SND_HDA
	help
	  Say Y here to support the HDA controller present in Nvidia
	  Tegra SoCs

	  This options enables support for the HD Audio controller
	  present in some Nvidia Tegra SoCs, used to communicate audio
	  to the HDMI output.

	  To compile this driver as a module, choose M here: the module
	  will be called snd-hda-tegra.

if SND_HDA

config SND_HDA_DSP_LOADER
	bool

config SND_HDA_PREALLOC_SIZE
	int "Pre-allocated buffer size for HD-audio driver"
	range 0 32768
	default 64
	help
	  Specifies the default pre-allocated buffer-size in kB for the
	  HD-audio driver.  A larger buffer (e.g. 2048) is preferred
	  for systems using PulseAudio.  The default 64 is chosen just
	  for compatibility reasons.

	  Note that the pre-allocation size can be changed dynamically
	  via a proc file (/proc/asound/card*/pcm*/sub*/prealloc), too.

config SND_HDA_HWDEP
	bool "Build hwdep interface for HD-audio driver"
	select SND_HWDEP
	help
	  Say Y here to build a hwdep interface for HD-audio driver.
	  This interface can be used for out-of-band communication
	  with codecs for debugging purposes.

config SND_HDA_RECONFIG
	bool "Allow dynamic codec reconfiguration"
	depends on SND_HDA_HWDEP
	help
	  Say Y here to enable the HD-audio codec re-configuration feature.
	  This adds the sysfs interfaces to allow user to clear the whole
	  codec configuration, change the codec setup, add extra verbs,
	  and re-configure the codec dynamically.

config SND_HDA_INPUT_BEEP
	bool "Support digital beep via input layer"
	depends on INPUT=y || INPUT=SND_HDA
	help
	  Say Y here to build a digital beep interface for HD-audio
	  driver. This interface is used to generate digital beeps.

config SND_HDA_INPUT_BEEP_MODE
	int "Digital beep registration mode (0=off, 1=on)"
	depends on SND_HDA_INPUT_BEEP=y
	default "1"
	range 0 1
	help
	  Set 0 to disable the digital beep interface for HD-audio by default.
	  Set 1 to always enable the digital beep interface for HD-audio by
	  default.

config SND_HDA_INPUT_JACK
	bool "Support jack plugging notification via input layer"
	depends on INPUT=y || INPUT=SND
	select SND_JACK
	help
	  Say Y here to enable the jack plugging notification via
	  input layer.

config SND_HDA_PATCH_LOADER
	bool "Support initialization patch loading for HD-audio"
	select FW_LOADER
	select SND_HDA_HWDEP
	select SND_HDA_RECONFIG
	help
	  Say Y here to allow the HD-audio driver to load a pseudo
	  firmware file ("patch") for overriding the BIOS setup at
	  start up.  The "patch" file can be specified via patch module
	  option, such as patch=hda-init.

	  This option turns on hwdep and reconfig features automatically.

config SND_HDA_CODEC_REALTEK
	tristate "Build Realtek HD-audio codec support"
	select SND_HDA_GENERIC
	help
	  Say Y or M here to include Realtek HD-audio codec support in
	  snd-hda-intel driver, such as ALC880.

config SND_HDA_CODEC_ANALOG
	tristate "Build Analog Device HD-audio codec support"
	select SND_HDA_GENERIC
	help
	  Say Y or M here to include Analog Device HD-audio codec support in
	  snd-hda-intel driver, such as AD1986A.

config SND_HDA_CODEC_SIGMATEL
	tristate "Build IDT/Sigmatel HD-audio codec support"
	select SND_HDA_GENERIC
	help
	  Say Y or M here to include IDT (Sigmatel) HD-audio codec support in
	  snd-hda-intel driver, such as STAC9200.

config SND_HDA_CODEC_VIA
	tristate "Build VIA HD-audio codec support"
	select SND_HDA_GENERIC
	help
	  Say Y or M here to include VIA HD-audio codec support in
	  snd-hda-intel driver, such as VT1708.

config SND_HDA_CODEC_HDMI
	tristate "Build HDMI/DisplayPort HD-audio codec support"
	select SND_DYNAMIC_MINORS
	default y
	help
	  Say Y or M here to include HDMI and DisplayPort HD-audio codec
	  support in snd-hda-intel driver.  This includes all AMD/ATI,
	  Intel and Nvidia HDMI/DisplayPort codecs.

config SND_HDA_I915
	bool "Build Display HD-audio controller/codec power well support for i915 cards"
	depends on DRM_I915
	help
	  Say Y here to include full HDMI and DisplayPort HD-audio controller/codec
	  power-well support for Intel Haswell graphics cards based on the i915 driver.

	  Note that this option must be enabled for Intel Haswell C+ stepping machines, otherwise
	  the GPU audio controller/codecs will not be initialized or damaged when exit from S3 mode.

config SND_HDA_CODEC_CIRRUS
	tristate "Build Cirrus Logic codec support"
	select SND_HDA_GENERIC
	help
	  Say Y or M here to include Cirrus Logic codec support in
	  snd-hda-intel driver, such as CS4206.

config SND_HDA_CODEC_CONEXANT
	tristate "Build Conexant HD-audio codec support"
	select SND_HDA_GENERIC
	help
	  Say Y or M here to include Conexant HD-audio codec support in
	  snd-hda-intel driver, such as CX20549.

config SND_HDA_CODEC_CA0110
	tristate "Build Creative CA0110-IBG codec support"
	select SND_HDA_GENERIC
	help
	  Say Y or M here to include Creative CA0110-IBG codec support in
	  snd-hda-intel driver, found on some Creative X-Fi cards.

config SND_HDA_CODEC_CA0132
	tristate "Build Creative CA0132 codec support"
	help
	  Say Y or M here to include Creative CA0132 codec support in
	  snd-hda-intel driver.

config SND_HDA_CODEC_CA0132_DSP
	bool "Support new DSP code for CA0132 codec"
	depends on SND_HDA_CODEC_CA0132 && FW_LOADER
	select SND_HDA_DSP_LOADER
	help
	  Say Y here to enable the DSP for Creative CA0132 for extended
	  features like equalizer or echo cancellation.

	  Note that this option requires the external firmware file
	  (ctefx.bin).

config SND_HDA_CODEC_CMEDIA
	tristate "Build C-Media HD-audio codec support"
	select SND_HDA_GENERIC
	help
	  Say Y or M here to include C-Media HD-audio codec support in
	  snd-hda-intel driver, such as CMI9880.

config SND_HDA_CODEC_SI3054
	tristate "Build Silicon Labs 3054 HD-modem codec support"
	help
	  Say Y or M here to include Silicon Labs 3054 HD-modem codec
	  (and compatibles) support in snd-hda-intel driver.

config SND_HDA_GENERIC
	tristate "Enable generic HD-audio codec parser"
	help
	  Say Y or M here to enable the generic HD-audio codec parser
	  in snd-hda-intel driver.

config SND_HDA_POWER_SAVE_DEFAULT
	int "Default time-out for HD-audio power-save mode"
	depends on PM
	default 0
	help
	  The default time-out value in seconds for HD-audio automatic
	  power-save mode.  0 means to disable the power-save mode.

endif

endmenu
```
