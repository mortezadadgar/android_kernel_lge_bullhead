## Documentation/devicetree/bindings/arm/tegra/nvidia,tegra20-pmc.txt
```
NVIDIA Tegra Power Management Controller (PMC)

The PMC block interacts with an external Power Management Unit. The PMC
mostly controls the entry and exit of the system from different sleep
modes. It provides power-gating controllers for SoC and CPU power-islands.

Required properties:
- name : Should be pmc
- compatible : Should contain "nvidia,tegra<chip>-pmc".
- reg : Offset and length of the register set for the device
- clocks : Must contain an entry for each entry in clock-names.
- clock-names : Must include the following entries:
  "pclk" (The Tegra clock of that name),
  "clk32k_in" (The 32KHz clock input to Tegra).

Optional properties:
- nvidia,invert-interrupt : If present, inverts the PMU interrupt signal.
  The PMU is an external Power Management Unit, whose interrupt output
  signal is fed into the PMC. This signal is optionally inverted, and then
  fed into the ARM GIC. The PMC is not involved in the detection or
  handling of this interrupt signal, merely its inversion.
- nvidia,suspend-mode : The suspend mode that the platform should use.
  Valid values are 0, 1 and 2:
  0 (LP0): CPU + Core voltage off and DRAM in self-refresh
  1 (LP1): CPU voltage off and DRAM in self-refresh
  2 (LP2): CPU voltage off
- nvidia,core-power-req-active-high : Boolean, core power request active-high
- nvidia,sys-clock-req-active-high : Boolean, system clock request active-high
- nvidia,combined-power-req : Boolean, combined power request for CPU & Core
- nvidia,cpu-pwr-good-en : Boolean, CPU power good signal (from PMIC to PMC)
			   is enabled.
- nvidia,reset-gpio : GPIO that can be used to warm reset the system.

Required properties when nvidia,suspend-mode is specified:
- nvidia,cpu-pwr-good-time : CPU power good time in uS.
- nvidia,cpu-pwr-off-time : CPU power off time in uS.
- nvidia,core-pwr-good-time : <Oscillator-stable-time Power-stable-time>
			      Core power good time in uS.
- nvidia,core-pwr-off-time : Core power off time in uS.

Required properties when nvidia,suspend-mode=<0>:
- nvidia,lp0-vec : <start length> Starting address and length of LP0 vector
  The LP0 vector contains the warm boot code that is executed by AVP when
  resuming from the LP0 state. The AVP (Audio-Video Processor) is an ARM7
  processor and always being the first boot processor when chip is power on
  or resume from deep sleep mode. When the system is resumed from the deep
  sleep mode, the warm boot code will restore some PLLs, clocks and then
  bring up CPU0 for resuming the system.

Example:

/ SoC dts including file
pmc@7000f400 {
	compatible = "nvidia,tegra20-pmc";
	reg = <0x7000e400 0x400>;
	clocks = <&tegra_car 110>, <&clk32k_in>;
	clock-names = "pclk", "clk32k_in";
	nvidia,invert-interrupt;
	nvidia,suspend-mode = <1>;
	nvidia,cpu-pwr-good-time = <2000>;
	nvidia,cpu-pwr-off-time = <100>;
	nvidia,core-pwr-good-time = <3845 3845>;
	nvidia,core-pwr-off-time = <458>;
	nvidia,core-power-req-active-high;
	nvidia,sys-clock-req-active-high;
	nvidia,lp0-vec = <0xbdffd000 0x2000>;
};

/ Tegra board dts file
{
	...
	clocks {
		compatible = "simple-bus";
		#address-cells = <1>;
		#size-cells = <0>;

		clk32k_in: clock {
			compatible = "fixed-clock";
			reg=<0>;
			#clock-cells = <0>;
			clock-frequency = <32768>;
		};
	};
	...
};

Wake up events

The PMC is the only device that can wake up the system from deep sleep
mode (i.e. LP0). There are some wake up events that in the PMC wake mask
register can be used to trigger PMC to wake up the system. The PMC wake
mask register defines which devices or siganls can be the source to
trigger PMC waking up. If the devices support waking up system from deep
sleep mode, then it needs to describe a property for PMC wake up events.
Here is the property defines the usage.

Required properties when nvidia,suspend-mode=<0>:
- nvidia,pmc-wakeup : <pmc_phandle event_type event_offset trigger_type>
		     pmc_phandle: the phandle of PMC device tree node
		     event_type: 0 = PMC_WAKE_TYPE_GPIO
				 1 = PMC_WAKE_TYPE_EVENT
		     event_offset: the offset of PMC wake mask register
		     trigger_type: set 0 when event_type is PMC_WAKE_TYPE_GPIO
				   if event_type is PMC_WAKE_TYPE_EVENT
				   0 = PMC_TRIGGER_TYPE_NONE
				   1 = PMC_TRIGGER_TYPE_RISING
				   2 = PMC_TRIGGER_TYPE_FALLING
				   4 = PMC_TRIGGER_TYPE_HIGH
				   8 = PMC_TRIGGER_TYPE_LOW
- #wake-cells : should be 3

Example:

/ SoC dts including file
pmc: pmc {
	compatible = "nvidia,tegra114-pmc";
	reg = <0x7000e400 0x400>;
	clocks = <&tegra_car 261>, <&clk32k_in>;
	clock-names = "pclk", "clk32k_in";
};

/ Tegra board dts file
{
	...
	pmc {
		...
		nvidia,suspend-mode = <0>;
		#wake-cells = <3>;
		...
	};
	...
	pmic {
		...
		nvidia,pmc-wakeup = <&pmc 1 18 8>;
		...
	};
	...
	rtc {
		...
		nvidia,pmc-wakeup = <&pmc 0 16 0>;
		...
	};
};
```

## Documentation/devicetree/bindings/clock/nvidia,tegra124-dfll,board-data.txt
```
DFLL board params node in the board DTS file

Required properties:
- sample-rate : control loop sample rate (in Hz)
- cf : I2C: duration to force the PMIC voltage after frequency change
- cg : loop gain (signed) - determined during board characterization
- ci : loop integral gain selector
- droop-cut-value : control output clock scaler at minimum ring osc freq
- droop-restore-ramp : clock recovery rate after a voltage droop event
- scale-out-ramp : voltage output ramp rate

Optional properties:
- no-output-forcing : don't force PMIC voltage output during request change
- fixed-output-forcing : force PMIC voltage during req change for a fixed time
- auto-output-forcing : force PMIC voltage during req change for a dynamic time
- cg-scale : if present, divide loop gain by 8 (see 'cg' above)

Note that one of 'no-output-forcing', 'fixed-output-forcing', or
'auto-output-forcing' must be specified.

Example:

cpu_dfll_board_params {
        sample-rate = <12500>;
        fixed-output-forcing;
        cf = <10>;
        ci = <0>;
        cg = <2>;
        droop-cut-value = <0xf>;
        droop-restore-ramp = <0x0>;
        scale-out-ramp = <0x0>;
};
```

## Documentation/devicetree/bindings/clock/nvidia,tegra124-dfll,cvb-table-characterization.txt
```
DFLL CVB table characterization data in the DFLL DTS file

Required properties:
- speedo-id : Note that the properties in this node are applicable for chips
              with this Speedo ID set in the chip's fuses.  See also
              the 'process-id' property below.
- therm-floors : list of two-cell arrays representing the minimum
                 voltage required on the DFLL voltage rail when the
                 temperature is at or below the given trip point.  The
                 first of the two cells is the trip point temperature
                 in degrees Celsius.  The second cell is the minimum
                 voltage in millivolts.
- therm-caps : list of two-cell arrays representing the maximum
               voltage limitted on the DFLL voltage rail when the
               temperature is at or above the trip point. The first
               of the two cells is the trip point temperature in
               degrees Celsius. The sencond cell is the maximum voltage
               in millivolts.
- cvb-max-millivolts : limit CVB starting voltages to this voltage.
- cvb-speedo-scale : silicon characterization multiplier, from e-fuses
- cvb-voltage-scale : CVB voltage scale factor (to microvolts)
- cvb-voltage-curves : list of four-cell arrays mapping the first cell
                       (the DFLL target frequency) to three
                       coefficients (the remaining three cells) used
                       to compute the starting voltage to program the
                       PMIC to.  The DFLL should automatically adjust
                       the PMIC voltage below this point.

Optional properties:
- process-id : If present, indicates that the properties in this node only
               apply to chips with the matching process ID set in the chip's
               fuses.  'speedo-id' must also match the chip fuses.

The address of the characterization nodes is arbitrary and ignored.

Example:

cpu_dfll_cvb_table {
        ...
        characterization@1 {
                speedo-id = <1>;
                process-id = <0>;

                therm-floors = < 20 1000>;
                therm-caps = < 62 1230 72 1210 82 1180>;
                cvb-max-millivolts = <1350>;
                cvb-speedo-scale = <100>;
                cvb-voltage-scale = <1000>;
                cvb-voltage-curves = < 306000000 2190643 0xfffdd5e5 3576>,
                                     < 408000000 2250968 0xfffdcc35 3576>,
                                     < 510000000 2313333 0xfffdc285 3576>,
                                     < 612000000 2377738 0xfffdb8d5 3576>,
                                     < 714000000 2444183 0xfffdaf25 3576>,
                                     < 816000000 2512669 0xfffda575 3576>,
                                     < 918000000 2583194 0xfffd9bc5 3576>,
                                     <1020000000 2655759 0xfffd9215 3576>,
                                     <1122000000 2730365 0xfffd8865 3576>,
                                     <1224000000 2807010 0xfffd7eb5 3576>,
                                     <1326000000 2885696 0xfffd7505 3576>,
                                     <1428000000 2966422 0xfffd6b55 3576>,
                                     <1530000000 3049183 0xfffd61af 3576>,
                                     <1606500000 3112179 0xfffd5a75 3576>,
                                     <1708500000 3198504 0xfffd50c5 3576>,
                                     <1810500000 3304747 0xfffd444a 3576>;
        };
};


...

DFLL CVB table data in the DFLL DTS file

Required properties:
- #address-cells : Set to 1
- #size-cells : Set to 0

Example:

cpu_dfll_cvb_table {
        #address-cells = <1>;
        #size-cells = <0>;

        characterization@1 {
                ...
        };
};
```

## Documentation/devicetree/bindings/clock/nvidia,tegra124-dfll,pmic-integration.txt
```
DFLL PMIC integration node in the board DTS file

Required properties:
- pmic-i2c-interface : selects the I2C interface to communicate with
                       the PMIC.  Future driver changes should add
                       support for the PWM interface, at which point
                       this should no longer be mandatory
- pmic-i2c-address : cell containing the PMIC I2C address
- pmic-i2c-voltage-register : cell containing the I2C register address of the
                              PMIC's set-output-voltage register, for the
                              rail that supplies the DFLL
- i2c-fs-rate : cell containing the I2C bus rate in Hz, in FS mode
- dfll-min-microvolt : minimum voltage in microvolts that the DFLL will
                       attempt to program the PMIC to supply
- dfll-max-microvolt : maximum voltage in microvolts that the DFLL will
                       attempt to program the PMIC to supply

Optional properties:
- i2c-10-bit-addresses : PMIC requires a 10-bit I2C address
- i2c-hs-rate : use high-speed I2C to communicate with the PMIC, at this
                rate (in Hz)
- i2c-hs-master-code : I2C master code to use - only applies in HS mode;
                       i2c-hs-rate must be set

Example:

cpu_dfll_pmic_integration {
        pmic-i2c-interface;
        pmic-i2c-address = <0x86>;
        pmic-i2c-voltage-register = <0x00>;
        i2c-fs-rate = <400000>;
        dfll-min-microvolt = <600000>;
        dfll-max-microvolt = <1400000>;
};
```

## Documentation/devicetree/bindings/clock/nvidia,tegra124-dfll,tuning-characterization.txt
```
DFLL silicon tuning characterization data in the DFLL DTS file

Required properties:
- speedo-id : Note that the properties in this node are applicable for chips
              with this Speedo ID set in the chip's fuses.  See also
              the 'process-id' property below.

- tune0-low-voltage-range: value to program into the DFLL_TUNE0
                           register when the DFLL's voltage rail is in
                           the low-voltage range. XXX This should be
                           broken up into the individual DFLL fields -
                           DT data shouldn't contain a raw register
                           value.

- tune0-high-voltage-range: value to program into the DFLL_TUNE0
                            register when the DFLL's voltage rail is in
                            the high-voltage range.  XXX This should be
                            broken up into the individual DFLL fields -
                            DT data shouldn't contain a raw register
                            value.

- tune1 : value to program into the DFLL_TUNE1 register. XXX This
          should be broken up into the individual DFLL fields - DT
          data shouldn't contain a raw register value.

- droop-rate-min : enable voltage droop control when the DVCO
                   frequency falls below this rate

- tune-high-min-millivolts : starting voltage of the DFLL's high-voltage range
                             (in millivolts).  The range between min-millivolts
                             and (tune-high-min-millivolts - 1) is the
                             low-voltage range.

- min-millivolts : starting voltage of the DFLL's low-voltage range (in
                   millivolts)

Optional properties:
- process-id : If present, indicates that the properties in this node only
               apply to chips with the matching process ID set in the chip's
               fuses.  'speedo-id' must also match the chip fuses.

The "address" of the characterization node is arbitrary and ignored.

Example:

cpu_dfll_tuning {
         ...

         characterization@1 {
                 speedo-id = <1>;
                 process-id = <0>;

                 tune0-low-voltage-range = <0x00b0039d>;
                 tune0-high-voltage-range = <0x00b0009d>;
                 tune1 = <0x0000001f>;
                 droop-rate-min = <1000000>;
                 tune-high-min-millivolts = <1000>;
                 min-millivolts = <900>;
         };
};


...

DFLL silicon tuning data in the DFLL DTS file:

Required properties:
- #address-cells : Set to 1
- #size-cells : Set to 0

The "address" of the characterization node is arbitrary and ignored.

Example:

cpu_dfll_tuning {
         #address-cells = <1>;
         #size-cells = <0>;

         characterization@1 {
                 ...
         };
};
```
