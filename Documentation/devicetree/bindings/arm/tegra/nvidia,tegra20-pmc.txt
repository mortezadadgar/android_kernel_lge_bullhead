## Documentation/devicetree/bindings/pinctrl/nvidia,tegra124-pinmux.txt
```
NVIDIA Tegra124 pinmux controller

The Tegra124 pinctrl binding is very similar to the Tegra114
pinctrl binding, as described in nvidia,tegra114-pinmux.txt. In fact, this
document assumes that binding as a baseline, and only documents the
differences between the two bindings.

Required properties:
- compatible: "nvidia,tegra124-pinmux"
- reg: Should contain the register physical address and length for each of
  the pad control and mux registers. The first bank of address must be the
  driver strength pad control register address and second bank address must
  be pinmux register address.

Tegra124 has the following optional properties for pin configuration subnodes:
- nvidia,enable-input: Integer. Enable the pin's input path. 0: no, 1: yes.
- nvidia,open-drain: Integer. Enable open drain mode. 0: no, 1: yes.
- nvidia,lock: Integer. Lock the pin configuration against further changes
    until reset. 0: no, 1: yes.
- nvidia,io-reset: Integer. Reset the IO path. 0: no, 1: yes.
- nvidia,rcv-sel: Integer. Select VIL/VIH receivers. 0: normal, 1: high.
- nvidia,drive-type: Integer. Valid range 0...3.

As with Tegra114, see the Tegra TRM for complete details regarding which
groups support which functionality.

Valid values for pin and group names are:

  per-pin mux groups:

    These all support nvidia,function, nvidia,tristate, nvidia,pull,
    nvidia,enable-input, nvidia,lock. Some support nvidia,open-drain,
    nvidia,io-reset and nvidia,rcv-sel.

    ulpi_data0_po1, ulpi_data1_po2, ulpi_data2_po3, ulpi_data3_po4,
    ulpi_data4_po5, ulpi_data5_po6, ulpi_data6_po7, ulpi_data7_po0,
    ulpi_clk_py0, ulpi_dir_py1, ulpi_nxt_py2, ulpi_stp_py3, dap3_fs_pp0,
    dap3_din_pp1, dap3_dout_pp2, dap3_sclk_pp3, pv0, pv1, sdmmc1_clk_pz0,
    sdmmc1_cmd_pz1, sdmmc1_dat3_py4, sdmmc1_dat2_py5, sdmmc1_dat1_py6,
    sdmmc1_dat0_py7, clk2_out_pw5, clk2_req_pcc5, hdmi_int_pn7, ddc_scl_pv4,
    ddc_sda_pv5, uart2_rxd_pc3, uart2_txd_pc2, uart2_rts_n_pj6,
    uart2_cts_n_pj5, uart3_txd_pw6, uart3_rxd_pw7, uart3_cts_n_pa1,
    uart3_rts_n_pc0, pu0, pu1, pu2, pu3, pu4, pu5, pu6, gen1_i2c_sda_pc5,
    gen1_i2c_scl_pc4, dap4_fs_pp4, dap4_din_pp5, dap4_dout_pp6, dap4_sclk_pp7,
    clk3_out_pee0, clk3_req_pee1, pc7, pi5, pi7, pk0, pk1, pj0, pj2, pk3,
    pk4, pk2, pi3, pi6, pg0, pg1, pg2, pg3, pg4, pg5, pg6, pg7, ph0, ph1,
    ph2, ph3, ph4, ph5, ph6, ph7, pj7, pb0, pb1, pk7, pi0, pi1, pj3, pi4,
    gen2_i2c_scl_pt5, gen2_i2c_sda_pt6, pex_lo_rst_n_pdd1,
    pex_lo_clkreq_n_pdd2, pex_wake_n_pdd3, pex_l1_rst_n_pdd5,
    pex_l1_clkreq_n_pdd6, sdmmc4_clk_pcc4, sdmmc4_cmd_pt7, sdmmc4_dat0_paa0,
    sdmmc4_dat1_paa1, sdmmc4_dat2_paa2, sdmmc4_dat3_paa3, sdmmc4_dat4_paa4,
    sdmmc4_dat5_paa5, sdmmc4_dat6_paa6, sdmmc4_dat7_paa7, cam_mclk_pcc0,
    pcc1, pbb0, cam_i2c_scl_pbb1, cam_i2c_sda_pbb2, pbb3, pbb4, pbb5, pbb6,
    pbb7, pcc2, pwr_i2c_scl_pz6, pwr_i2c_sda_pz7, kb_row0_pr0, kb_row1_pr1,
    kb_row2_pr2, kb_row3_pr3, kb_row4_pr4, kb_row5_pr5, kb_row6_pr6,
    kb_row7_pr7, kb_row8_ps0, kb_row9_ps1, kb_row10_ps2, kb_row11_ps3,
    kb_row12_ps4, kb_row13_ps5, kb_row14_ps6, kb_row15_ps7, kb_row16_pt0,
    kb_row17_pt1, kb_col0_pq0, kb_col1_pq1, kb_col2_pq2, kb_col3_pq3,
    kb_col4_pq4, kb_col5_pq5, kb_col6_pq6, kb_col7_pq7, clk_32k_out_pa0,
    core_pwr_req, cpu_pwr_req, pwr_int_n, owr, dap1_fs_pn0, dap1_din_pn1,
    dap1_dout_pn2, dap1_sclk_pn3, dap_mclk1_req_pee2, dap_mclk1_pw4,
    spdif_in_pk6, spdif_out_pk5, dap2_fs_pa2, dap2_din_pa4, dap2_dout_pa5,
    dap2_sclk_pa3, dvfs_pwm_px0, gpio_x1_aud_px1, gpio_x3_aud_px3,
    dvfs_clk_px2, gpio_x4_aud_px4, gpio_x5_aud_px5, gpio_x6_aud_px6,
    gpio_x7_aud_px7, sdmmc3_clk_pa6, sdmmc3_cmd_pa7, sdmmc3_dat0_pb7,
    sdmmc3_dat1_pb6, sdmmc3_dat2_pb5, sdmmc3_dat3_pb4, hdmi_cec_pee3,
    sdmmc1_wp_n_pv3, sdmmc3_cd_n_pv2, gpio_w2_aud_pw2, gpio_w3_aud_pw3,
    usb_vbus_en0_pn4, usb_vbus_en1_pn5, sdmmc3_clk_lb_in_pee5,
    sdmmc3_clk_lb_out_pee4, reset_out_n, dp_hpd_pff0, usb_vbus_en2_pff1,
    pff2, clk_32k_in, gmi_clk_lb, jtag_rtck.

  drive groups:

    These all support nvidia,pull-down-strength, nvidia,pull-up-strength,
    nvidia,slew-rate-rising, nvidia,slew-rate-falling. Most but not all
    support nvidia,high-speed-mode, nvidia,schmitt, nvidia,low-power-mode
    and nvidia,drive-type.

    ao1, ao2, at1, at2, at3, at4, at5, cdev1, cdev2, dap1, dap2, dap3, dap4,
    dbg, sdio3, spi, uaa, uab, uart2, uart3, sdio1, ddc, gma, gme, gmf, gmg,
    gmh, owr, uda, gpv, dev3, cec, at6, dap5, usb_vbus_en, ao3, ao0, hv0,
    sdio4, ao4.

Example:

	pinmux: pinmux {
		compatible = "nvidia,tegra124-pinmux";
		reg = <0x70000868 0x148		/* Pad control registers */
		       0x70003000 0x40c>;	/* PinMux registers */
	};

Example board file extract:

	pinctrl {
		sdmmc4_default: pinmux {
			sdmmc4_clk_pcc4 {
				nvidia,pins = "sdmmc4_clk_pcc4",
				nvidia,function = "sdmmc4";
				nvidia,pull = <0>;
				nvidia,tristate = <0>;
			};
			sdmmc4_dat0_paa0 {
				nvidia,pins = "sdmmc4_dat0_paa0",
						"sdmmc4_dat1_paa1",
						"sdmmc4_dat2_paa2",
						"sdmmc4_dat3_paa3",
						"sdmmc4_dat4_paa4",
						"sdmmc4_dat5_paa5",
						"sdmmc4_dat6_paa6",
						"sdmmc4_dat7_paa7";
				nvidia,function = "sdmmc4";
				nvidia,pull = <2>;
				nvidia,tristate = <0>;
			};
		};
	};

	sdhci@78000400 {
		pinctrl-names = "default";
		pinctrl-0 = <&sdmmc4_default>;
	};
```

## Documentation/devicetree/bindings/sound/max98090.txt
```
MAX98090 audio CODEC

Required properties:

  - compatible : "maxim,max98090".

  - reg : the I2C address of the device for I2C

Optional properties:

  - interrupts : The interrupt line the IRQ signal tat the device is
    connected to.  This is optional, if it is not connected then none
    of the interrupt related properties should be specified.
  - interrupt-parent : The parent interrupt controller.

  - dvdd-supply : power supply for the device, as covered
    in Documentation/devicetree/bindings/regulator/regulator.txt

Example:

max98090: max98090 {
	compatible = "maxim,max98090";
	reg = <0x10>;
	interrupt-parent = <&gpio>;
	interrupts = <TEGRA_GPIO(H, 4) GPIO_ACTIVE_HIGH>;
	dvdd-supply = <&gen_avdd_1v2>;
};
```

## Documentation/devicetree/bindings/sound/nvidia,tegra-audio-max98090.txt
```
NVIDIA Tegra audio complex, with MAX98090 CODEC

Required properties:
- compatible : "nvidia,tegra-audio-max98090"
- clocks : Must contain an entry for each entry in clock-names.
- clock-names : Must include the following entries:
  "pll_a" (The Tegra clock of that name),
  "pll_a_out0" (The Tegra clock of that name),
  "mclk" (The Tegra cdev1/extern1 clock, which feeds the CODEC's mclk)
- nvidia,model : The user-visible name of this sound complex.
- nvidia,audio-routing : A list of the connections between audio components.
  Each entry is a pair of strings, the first being the connection's sink,
  the second being the connection's source. Valid names for sources and
  sinks are the MAX98090's pins, and the jacks on the board.

  Board connectors:

  * Headphones
  * Speakers
  * Mic Jack

- nvidia,i2s-controller : The phandle of the Tegra I2S controller that's
  connected to the CODEC.
- nvidia,audio-codec : The phandle of the MAX98090 audio codec. This binding
  assumes that AIF1 on the CODEC is connected to Tegra.

Optional properties:
- nvidia,hp-det-gpios : The GPIO that detects headphones are plugged in
- nvidia,mic-det-gpios : The GPIO that detects if an external mic is plugged in

Example:

  sound {
    compatible = "nvidia,tegra-audio-max98090-venice2",
           "nvidia,tegra-audio-max98090";
    nvidia,model = "NVIDIA Tegra Venice2";

    nvidia,audio-routing =
      "Headphones", "HPR",
      "Headphones", "HPL",
      "Speakers", "SPKR",
      "Speakers", "SPKL";

    nvidia,i2s-controller = <&tegra_i2s1>;
    nvidia,audio-codec = <&max98090>;

    clocks = <&tegra_car 216>, <&tegra_car 217>, <&tegra_car 120>;
    clock-names = "pll_a", "pll_a_out0", "mclk";
  };
```

## Documentation/devicetree/bindings/thermal/tegra-soctherm.txt
```
* Tegra114/124 SOC_THERM

** Thermal node required properties:

- compatible : "nvidia,tegra124-soctherm" or "nvidia,tegra114-soctherm".
- reg : address range of the thermal sensor registers;
- interrupts : irq for soc_therm.
- clocks : clocks for soc_therm.
- clock-names : clock names for soc_therm.
- pmu-16bit-ops : 16bit ops.
- pmu-i2c-addr : i2c slave address.
- i2c-controller-id : i2c controller id.
- poweroff-reg-addr : pmu poweroff register address.
- poweroff-reg-data : pmu poweroff register data.

** Optional properties:
- cpu-edp-cdev: handle of the cpu-edp thermal recation node,
which will be bound with this soc_therm thermal zone.

Example soc_therm node:

soc_therm {
	compatible = "nvidia,tegra124-soctherm";
	reg = <0x700e2000 0x1000>;
	clocks = <&tegra_car 78>, <&tegra_car 100>;
	clock-names = "soc_therm", "tsensor";
	pmu-16bit-ops = <0>;
	pmu-i2c-addr = <0x40>;
	i2c-controller-id = <4>;
	poweroff-reg-addr = <0x36>;
	poweroff-reg-data = <0x2>;

	cpu-edp-cdev = <&{/cpu_edp_cdev_action}>;
};
```

## Documentation/devicetree/bindings/thermal/tegra-thermal-action.txt
```
* Tegra thermal reaction node

** Required properties:

- compatible : "nvidia,tegra124-dfll-cdev-action".
- act-dev: node of the device which will implement the real cooling action.
- cdev-floor-type: name of the cooling device for thermal floor.
- cdev-cap-type: name of the cooling device for thermal cap.

Example node:

dfll_cdev_action {
	compatible = "nvidia,tegra124-dfll-cdev-action";
	act-dev = <&{/dfll@70110000}>;
	cdev-floor-type = "DFLL-foor";
	cdev-cap-type = "DFLL-cap";
};
```

## Documentation/devicetree/bindings/thermal/tegra124_throttle.txt
```
tegra124 thermal throttle devicetree bindings

This device is used for thermal throttle, and has number of properties.

Required properties:
 - compatible:		we now support "nvidia,tegra124-tj-throttle".
 - clocks:		core shared clocks, we now support:
			cap.throttle.c3bus, cap.throttle.sclk, cap.throttl.emc
 - cpu-balanced-states	phandle of the cpu balanced throttle state.

====throttle state====
Required properties:
 - cpu-freq:		the limit of cpu freq in this throttle state.
Optional properties:
 - gpu-freq:		the limit of gpu freq in this throttle state.
			if omitted, it mean no limits for it.
 - c3bus-freq:		the limit of c3bus freq in this throttle state.
			if omitted, it mean no limits for it.
 - sclk-freq:		the limit of sclk freq in this throttle state.
			if omitted, it mean no limits for it.
 - emc-freq:		the limit of emc freq in this throttle state.
			if omitted, it mean no limits for it.

Example:
tj-temperature-throttling {
	compatible = "nvidia,tegra124-tj-throttle";
	clocks = <&tegra_car 418>, <&tegra_car 429>, <&tegra_car 459>;
	clock-names = "cap.throttle.c3bus", "cap.throttle.sclk", "cap.throttle.emc";
	cpu-balanced-states = <&{/cpu-throttling-state}>;
};

cpu-throttling-state {
	throt-state@0 {
		cpu-freq = <739500>;
		gpu-freq = <550000>;
	};
	throt-state@1 {
		cpu-freq = <714000>;
		c2bus-freq = <555000>;
	};
};

gpu-throttling-state {
	throt-state@0 {
		cpu-freq = <2295000>;
		gpu-freq = <782800>;
		c3bus-freq = <756000>;
		sclk-freq = <384000>;
		emc-freq = <924000>;
	};
};
```

## Documentation/devicetree/bindings/thermal/tegra_therm_est.txt
```
Thermal estimator driver.

Required properties:
 - compatible:	"nvidia,tegra124-therm-est".
 - toffset:	Temperature offset for thermal estimation, in milli-celsius.
 - polling-period: Polling wait times for thermal estimation, in milliseconds.
 - tc1:		Coefficient 1 for thermal trend calculation.
 - tc2:		Coefficient 2 for thermal trend calculation.
 - node for subdev: Node for subdevice information.

Properties in subdevice node:
 - dev: device node of the thermal zone device for thermal estimation.
 - coeffs : An array of coefficients, the number of entries should be twenty.

Example:
	skin_temp: therm-est {
		compatible = "nvidia,tegra124-therm-est";
		toffset = <9793>;
		tc1 = <10>;
		tc2 = <1>;
		polling-period = <1100>;

		#thermal-sensor-cells = <0>;

		sub-devs {
			dev@0 {
				dev = <&diode>;
				coeffs = "2 1 1 1 1 1 1 1 1 1 1 0 1 1 0 0 0 0 -1 -7";
			};

			dev@1 {
				dev = <&board>;
				coeffs = "-11 -7 -5 -3 -3 -2 -1 0 0 0 1 1 1 2 2 3 4 6 11 18";
			};
		};
	};
```

## Documentation/devicetree/bindings/video/backlight/pwm-backlight.txt
```
pwm-backlight bindings

Required properties:
  - compatible: "pwm-backlight"
  - pwms: OF device-tree PWM specification (see PWM binding[0])
  - brightness-levels: Array of distinct brightness levels. Typically these
      are in the range from 0 to 255, but any range starting at 0 will do.
      The actual brightness level (PWM duty cycle) will be interpolated
      from these values. 0 means a 0% duty cycle (darkest/off), while the
      last value in the array represents a 100% duty cycle (brightest).
  - default-brightness-level: the default brightness level (index into the
      array defined by the "brightness-levels" property)

Optional properties:
  - pwm-names: a list of names for the PWM devices specified in the
               "pwms" property (see PWM binding[0])
  - enable-gpio: a GPIO used to enable the backlight.

Child device nodes describe alternate brightness-levels tables for different
display/backlight configurations.

[0]: Documentation/devicetree/bindings/pwm/pwm.txt

Example:

	backlight {
		compatible = "pwm-backlight";
		pwms = <&pwm 0 5000000>;

		brightness-levels = <0 4 8 16 32 64 128 255>;
		default-brightness-level = <6>;
		enable-gpio = <&gpx3 0 0>;
	};

Alternate brightness-levels tables

Child device nodes can specify multiple alternate brightness-levels tables,
identified by a generic string, and is selected upon calling the backlight
device's brightness_choose().

Properties:
- compatible: "pwm-backlight-alt-brightness-levels"
- identifier: A string that is used during backlight_choose() to select the
    particular alternate brightness-levels table.
- brightness-levels: See the brightness-levels property of the parent node,
    described earlier in this documentation.  Note that the length of these
    alternate brightness-level tables must be the same as the original
    brightness-levels table from the parent node.

Example:
	panel@0 {
		compatible = "pwm-backlight-alt-brightness-levels";
		identifier = "CMN-1132-1"
		brightness-levels = <0 16 32 40 80 120 160 255>;
	};
```
