## Documentation/devicetree/bindings/clock/nvidia,tegra124-dfll.txt
```
NVIDIA Tegra124 DFLL clocksource data in the SoC DTS file:

Required properties:
- compatible : "nvidia,tegra124-dfll"
- reg : Must contain the starting physical address and length for the
        DFLL's MMIO register space, including the DFLL-to-I2C
        controller interface and the DFLL's I2C controller.
- clocks : Must contain an array of two-cell arrays, one per clock.
           DFLL source clocks.  At minimum this should include the
           reference clock source and the IP block's main clock
           source.  Also it should contain the DFLL's I2C controller
           clock source.  The format is <&clock-provider-phandle
           clock-id>.
- clock-names : Must contain an array of strings, one per 'clocks'
                two-cell array.  The position in the array of these
                strings must correspond to the position in the 'clocks'
                array (see above).  The DFLL driver currently requires
                the "soc", "ref", and "i2c" clock names to be populated.

Optional properties:
- status : device availability -- managed by the DT integration code, not
           the DFLL driver.  Should be set to "disabled" in the SoC
           DTS file.

Example:

dfll@70110000 {
        compatible = "nvidia,tegra124-dfll";
        reg = <0x70110000 0x400>;
        clocks = <&tegra_car 265>, <&tegra_car 264>, <&tegra_car 47>;
        clock-names = "soc", "ref", "i2c";
        status = "disabled";
};


...

NVIDIA Tegra124 DFLL clocksource data in the board DTS file

Required properties:
- vdd-supply : phandle pointing to the DFLL's voltage regulator
- pmic-integration : phandle pointing to the PMIC integration data
                     for this DFLL instance
- board-params : phandle pointing to the board-specific tuning data
                 for this DFLL instance
- cvb-table : phandle pointing to the DFLL-specific CVB table for
              this DFLL instance

Optional properties:
- i2c-quiet-output-workaround : If the DFLL IP block version
                                implemented on this SoC requires the
                                I2C output to the PMIC to be quiesced
                                before disabling it, this property
                                should be set.
- status : device availability -- managed by the DT integration code, not
           the DFLL driver.  Should be set to "okay" if the DFLL is to be
           used on this board type.

Example:

dfll@70110000 {
        vdd-supply = <&vdd_cpu_reg>;
        board-params = <&{/cpu_dfll_board_params}>;
        pmic-integration = <&{/cpu_dfll_pmic_integration}>;
        status = "okay";
};
```

## Documentation/devicetree/bindings/edp/tegra_cpu_edp.txt
```
* Tegra124 VDD_CPU EDP Management

.. CPU EDP node required properties:

- compatible : "nvidia,tegra124-cpu-edp".
- regulator-ma: maximum cpu current support, in milliampere.

Example:

cpu_edp {
	compatible = "nvidia,tegra124-cpu-edp";
	regulator-ma = <8000>;
};
```

## Documentation/devicetree/bindings/fuse/fuse-tegra.txt
```
NVIDIA Tegra20/Tegra30/Tegr114/Tegra124 fuse driver.

Required properties:
- compatible : should be:
	"nvidia,tegra20-efuse"
	"nvidia,tegra30-efuse"
	"nvidia,tegra114-efuse"
	"nvidia,tegra124-efuse"
  Details:
  nvidia,tegra20-efuse: Tegra20 requires using APB DMA to read the fuse data
	due to a hardware bug. Tegra20 also lacks certain information which is
	available in later generations such as fab code, lot code, wafer id,..
  nvidia,tegra30-efuse, nvidia,tegra114-efuse and nvidia,tegra124-efuse:
	The differences between these SoCs are the size of the efuse array,
	the location of the spare (OEM programmable) bits and the location of
	the speedo data.
- reg: Should contain 2 entries: the first entry gives the physical address
       and length of the fuse registers, the second entry gives the physical
       address and length of the apbmisc registers. These are used to provide
       the chipid, chip revision and strapping options.
- clocks: Should contain a pointer to the fuse clock.

Example:

        fuse@7000f800 {
                compatible = "nvidia,tegra20-efuse";
                reg = <0x7000F800 0x400>,
                      <0x70000000 0x400>;
                clocks = <&tegra_car TEGRA20_CLK_FUSE>;
        };
```

## Documentation/devicetree/bindings/iommu/nvidia,tegra30-smmu.txt
```
NVIDIA Tegra 30 IOMMU H/W, SMMU (System Memory Management Unit)

Required properties in the IOMMU node:
- compatible : "nvidia,tegra124-smmu", "nvidia,tegra30-smmu"
- reg : Can contain multiple register banks(address and length) for each
  of the SMMU register blocks.
- interrupts : Should contain MC General interrupt.
- nvidia,#asids : # of ASIDs
- dma-window : IOVA start address and length.
- nvidia,ahb : phandle to the ahb bus connected to SMMU.
- iommus: phandle to an iommu device which a device is
  attached to and indicates which swgroups a device belongs to(SWGROUP ID).
  SWGROUP ID is from 0 to 63, and a device can belong to multiple SWGROUPS.
- #iommu-cells. Should be 2. In client IOMMU specifiers, the two cells
  represent a 64-bit bitmask of SWGROUP IDs under which the device
  initiates transactions. The least significant word is first. See
  <dt-bindings/memory/tegra-swgroup.h> for a list of valid values.

Required properties in device nodes affected by the IOMMU:
- iommus: A list of phandle plus specifier pairs for each IOMMU that
  affects master transactions initiated by the device. The number of
  cells in each specifier is defined by the #iommu-cells property in
  the IOMMU node referred to by the phandle. The meaning of the
  specifier cells is defined by the referenced IOMMU's binding.

Example:
	smmu: iommu {
		compatible = "nvidia,tegra30-smmu";
		reg = <0x7000f010 0x02c
		       0x7000f1f0 0x010
		       0x7000f228 0x05c>;
		nvidia,#asids = <4>;		/* # of ASIDs */
		dma-window = <0 0x40000000>;	/* IOVA start & length */
		nvidia,ahb = <&ahb>;
		#iommu-cells = <2>;
	};

	host1x {
		compatible = "nvidia,tegra30-host1x", "simple-bus";
		iommus = <&smmu TEGRA_SWGROUP_CELLS(HC)>;
		....
		gr3d {
			compatible = "nvidia,tegra30-gr3d";
			iommus = <&smmu TEGRA_SWGROUP_CELLS(NV)
					TEGRA_SWGROUP_CELLS(NV2)>;
			....
		};
```

## Documentation/devicetree/bindings/mfd/as3722.txt
```
* ams AS3722 Power management IC.

Required properties:
-------------------
- compatible: Must be "ams,as3722".
- reg: I2C device address.
- interrupt-controller: AS3722 has internal interrupt controller which takes the
  interrupt request from  internal sub-blocks like RTC, regulators, GPIOs as well
  as external input.
- #interrupt-cells: Should be set to 2 for IRQ number and flags.
  The first cell is the IRQ number.
  The second cell is the flags, encoded as the trigger masks from binding document
	interrupts.txt, using dt-bindings/irq.

Optional submodule and their properties:
---------------------------------------

Pinmux and GPIO:
---------------
Device has 8 GPIO pins which can be configured as GPIO as well as the special IO
functions.

Please refer to pinctrl-bindings.txt in this directory for details of the
common pinctrl bindings used by client devices, including the meaning of the
phrase "pin configuration node".

Following are properties which is needed if GPIO and pinmux functionality
is required:
- gpio-controller: Marks the device node as a GPIO controller.
- #gpio-cells: Number of GPIO cells. Refer to binding document gpio/gpio.txt
- pinctrl-names: A pinctrl state named "default" must be defined, using the
		bindings in pinctrl/pinctrl-binding.txt.
- pinctrl[0...n]: Nodes for pin control to represents state 0 to state n.
	Each of these nodes contains different subnodes to represents
	some desired configuration for a list of pins. This configuration can
	include the mux function to select on those pin(s), and various pin
	configuration parameters, such as pull-up, open drain.

Each subnode have following properties:
Required properties:
	pins: List of pins. Valid options for pins properties are
		gpio0, gpio1, gpio2, gpio3, gpio4, gpio5, gpio6, gpio7

Optional properties:
	Optional properties are
		function, bias-disable, bias-pull-up, bias-pull-down,
		bias-high-impedance, drive-open-drain, low-power-enable

		Valid options for funtion properties are:
		gpio, interrupt-out, gpio-in-interrupt,
		vsup-vbat-low-undebounce-out, vsup-vbat-low-debounce-out,
		voltage-in-standby, oc-pg-sd0, oc-pg-sd6, powergood-out,
		pwm-in, pwm-out, clk32k-out, watchdog-in, soft-reset-in

Regulators:
-----------
Device has multiple DCDC and LDOs. The node "regulators" is require if regulator
functionality is needed.

Following are properties of regulator subnode.

Optional properties:
-------------------
The input supply of regulators are the optional properties on the
regulator node. The input supply of these regulators are provided
through following properties:
vsup-sd2-supply: Input supply for SD2.
vsup-sd3-supply: Input supply for SD3.
vsup-sd4-supply: Input supply for SD4.
vsup-sd5-supply: Input supply for SD5.
vin-ldo0-supply: Input supply for LDO0.
vin-ldo1-6-supply: Input supply for LDO1 and LDO6.
vin-ldo2-5-7-supply: Input supply for LDO2, LDO5 and LDO7.
vin-ldo3-4-supply: Input supply for LDO3 and LDO4.
vin-ldo9-10-supply: Input supply for LDO9 and LDO10.
vin-ldo11-supply: Input supply for LDO11.

Optional sub nodes:
-----------------
	The subnodes name is the name of regulator and it must be one of:
	sd[0-6], ldo[0-7], ldo[9-11]

	Each sub-node should contain the constraints and initialization
	information for that regulator. See regulator.txt for a description
	of standard properties for these sub-nodes.
	Additional custom properties  are listed below.
		ams,ext-control: External control of the rail. The option of
			this properties will tell which external input is
			controlling this rail. Valid values are 0, 1, 2 ad 3.
			0: There is no external control of this rail.
			1: Rail is controlled by ENABLE1 input pin.
			2: Rail is controlled by ENABLE2 input pin.
			3: Rail is controlled by ENABLE3 input pin.
		ams,enable-tracking: Enable tracking with SD1, only supported
			by LDO3.

Clock:
======
AS3722 supports one 32KHz clock to output from device. The clock control is
provided through the clock driver.
This binding uses the common clock binding ./clock-bindings.txt.
The device node should have the optional properties to support the clock:
#clock-cells: from common clock binding; shall be set to 1. The clock id for
	single clock output is 0.

Power-off:
=========

AS3722 supports the system power off by turning off all its rail. The power off
is provided through pm power off.
The device node should have the following properties to enable power-off
functionality from ams AS3722:
ams,system-power-controller: To enable the power off functionality through
	device.

Example:
--------
ams3722 {
	compatible = "ams,as3722";
	reg = <0x48>;

	interrupt-parent = <&intc>;
	interrupt-controller;
	#interrupt-cells = <2>;

	gpio-controller;
	#gpio-cells = <2>;

	pinctrl-names = "default";
	pinctrl-0 = <&as3722_default>;

	as3722_default: pinmux {
			gpio0 {
				pins = "gpio0";
				function = "gpio";
				bias-pull-down;
				low-power-enable =
					AS3722_GPIO_LOW_POWER_MODE(4, 0x7);
			};

			gpio1_2_4_7 {
				pins = "gpio1", "gpio2", "gpio4", "gpio7";
				function = "gpio";
				bias-pull-up;
			};

			gpio5 {
				pins = "gpio5";
				function = "clk32k_out";
			};
	}

	regulators {
			vsup-sd2-supply = <...>;
			...

			sd0 {
				regulator-name = "vdd_cpu";
				regulator-min-microvolt = <700000>;
				regulator-max-microvolt = <1400000>;
				regulator-always-on;
				ams,ext-control = <2>;
			};

			sd1 {
				regulator-name = "vdd_core";
				regulator-min-microvolt = <700000>;
				regulator-max-microvolt = <1400000>;
				regulator-always-on;
				ams,ext-control = <1>;
			};

			sd2 {
				regulator-name = "vddio_ddr";
				regulator-min-microvolt = <1350000>;
				regulator-max-microvolt = <1350000>;
				regulator-always-on;
			};

			sd4 {
				regulator-name = "avdd-hdmi-pex";
				regulator-min-microvolt = <1050000>;
				regulator-max-microvolt = <1050000>;
				regulator-always-on;
			};

			sd5 {
				regulator-name = "vdd-1v8";
				regulator-min-microvolt = <1800000>;
				regulator-max-microvolt = <1800000>;
				regulator-always-on;
			};
			....
	};
};
```
