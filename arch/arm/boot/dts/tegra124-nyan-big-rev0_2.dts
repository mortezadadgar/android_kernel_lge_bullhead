/dts-v1/;

#include "tegra124-nyan-big.dtsi"

/ {
	model = "Google Nyan Big Rev 0-2";

	compatible = "google,nyan-big-rev2", "google,nyan-big-rev1",
			"google,nyan-big-rev0", "google,nyan-big",
			"google,nyan", "nvidia,tegra124";

	sdhci@700b0600 {
		max-frequency = <136000000>;
	};
};
