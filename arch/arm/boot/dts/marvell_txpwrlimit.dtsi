/ {
	marvell_cfgdata {
		marvell,caldata_00_txpwrlimit_2g_cfg_set = /bits/ 8 <
0x01 0x00 0x06 0x00 0x30 0x02 0x89 0x01
0x24 0x00 0x67 0x09 0x14 0x01 0x00 0x0f 0x01 0x0e 0x02 0x0e 0x03 0x0e 0x04 0x0d
0x05 0x0d 0x06 0x0d 0x07 0x0b 0x08 0x0b 0x09 0x0b 0x0a 0x0d 0x0b 0x0d 0x0c 0x0d
0x0d 0x0b 0x0e 0x0b 0x0f 0x0b 0x89 0x01 0x24 0x00 0x67 0x09 0x14 0x02 0x00 0x0f
0x01 0x0e 0x02 0x0e 0x03 0x0e 0x04 0x0d 0x05 0x0d 0x06 0x0d 0x07 0x0b 0x08 0x0b
0x09 0x0b 0x0a 0x0d 0x0b 0x0d 0x0c 0x0d 0x0d 0x0b 0x0e 0x0b 0x0f 0x0b 0x89 0x01
0x24 0x00 0x67 0x09 0x14 0x03 0x00 0x0f 0x01 0x0e 0x02 0x0e 0x03 0x0e 0x04 0x0d
0x05 0x0d 0x06 0x0d 0x07 0x0b 0x08 0x0b 0x09 0x0b 0x0a 0x0d 0x0b 0x0d 0x0c 0x0d
0x0d 0x0b 0x0e 0x0b 0x0f 0x0b 0x89 0x01 0x24 0x00 0x67 0x09 0x14 0x04 0x00 0x0f
0x01 0x0e 0x02 0x0e 0x03 0x0e 0x04 0x0d 0x05 0x0d 0x06 0x0d 0x07 0x0b 0x08 0x0b
0x09 0x0b 0x0a 0x0d 0x0b 0x0d 0x0c 0x0d 0x0d 0x0b 0x0e 0x0b 0x0f 0x0b 0x89 0x01
0x24 0x00 0x67 0x09 0x14 0x05 0x00 0x0f 0x01 0x0e 0x02 0x0e 0x03 0x0e 0x04 0x0d
0x05 0x0d 0x06 0x0d 0x07 0x0b 0x08 0x0b 0x09 0x0b 0x0a 0x0d 0x0b 0x0d 0x0c 0x0d
0x0d 0x0b 0x0e 0x0b 0x0f 0x0b 0x89 0x01 0x24 0x00 0x67 0x09 0x14 0x06 0x00 0x0f
0x01 0x0e 0x02 0x0e 0x03 0x0e 0x04 0x0d 0x05 0x0d 0x06 0x0d 0x07 0x0b 0x08 0x0b
0x09 0x0b 0x0a 0x0d 0x0b 0x0d 0x0c 0x0d 0x0d 0x0b 0x0e 0x0b 0x0f 0x0b 0x89 0x01
0x24 0x00 0x67 0x09 0x14 0x07 0x00 0x0f 0x01 0x0e 0x02 0x0e 0x03 0x0e 0x04 0x0d
0x05 0x0d 0x06 0x0d 0x07 0x0b 0x08 0x0b 0x09 0x0b 0x0a 0x0d 0x0b 0x0d 0x0c 0x0d
0x0d 0x0b 0x0e 0x0b 0x0f 0x0b 0x89 0x01 0x24 0x00 0x67 0x09 0x14 0x08 0x00 0x0f
0x01 0x0e 0x02 0x0e 0x03 0x0e 0x04 0x0d 0x05 0x0d 0x06 0x0d 0x07 0x0b 0x08 0x0b
0x09 0x0b 0x0a 0x0d 0x0b 0x0d 0x0c 0x0d 0x0d 0x0b 0x0e 0x0b 0x0f 0x0b 0x89 0x01
0x24 0x00 0x67 0x09 0x14 0x09 0x00 0x0f 0x01 0x0e 0x02 0x0e 0x03 0x0e 0x04 0x0d
0x05 0x0d 0x06 0x0d 0x07 0x0b 0x08 0x0b 0x09 0x0b 0x0a 0x0d 0x0b 0x0d 0x0c 0x0d
0x0d 0x0b 0x0e 0x0b 0x0f 0x0b 0x89 0x01 0x24 0x00 0x67 0x09 0x14 0x0a 0x00 0x0f
0x01 0x0e 0x02 0x0e 0x03 0x0e 0x04 0x0d 0x05 0x0d 0x06 0x0d 0x07 0x0b 0x08 0x0b
0x09 0x0b 0x0a 0x0d 0x0b 0x0d 0x0c 0x0d 0x0d 0x0b 0x0e 0x0b 0x0f 0x0b 0x89 0x01
0x24 0x00 0x67 0x09 0x14 0x0b 0x00 0x0f 0x01 0x0e 0x02 0x0e 0x03 0x0e 0x04 0x0d
0x05 0x0d 0x06 0x0d 0x07 0x0b 0x08 0x0b 0x09 0x0b 0x0a 0x0d 0x0b 0x0d 0x0c 0x0d
0x0d 0x0b 0x0e 0x0b 0x0f 0x0b 0x89 0x01 0x24 0x00 0x67 0x09 0x14 0x0c 0x00 0x0f
0x01 0x0e 0x02 0x0e 0x03 0x0e 0x04 0x0d 0x05 0x0d 0x06 0x0d 0x07 0x0b 0x08 0x0b
0x09 0x0b 0x0a 0x0d 0x0b 0x0d 0x0c 0x0d 0x0d 0x0b 0x0e 0x0b 0x0f 0x0b 0x89 0x01
0x24 0x00 0x67 0x09 0x14 0x0d 0x00 0x0f 0x01 0x0e 0x02 0x0e 0x03 0x0e 0x04 0x0d
0x05 0x0d 0x06 0x0d 0x07 0x0b 0x08 0x0b 0x09 0x0b 0x0a 0x0d 0x0b 0x0d 0x0c 0x0d
0x0d 0x0b 0x0e 0x0b 0x0f 0x0b 0x89 0x01 0x24 0x00 0x6e 0x09 0x14 0x0e 0x00 0x0b
0x01 0x0a 0x02 0x0a 0x03 0x0a 0x04 0x0a 0x05 0x0a 0x06 0x0a 0x07 0x09 0x08 0x09
0x09 0x09 0x0a 0x0a 0x0b 0x0a 0x0c 0x0a 0x0d 0x09 0x0e 0x09 0x0f 0x09
		>;
	};
};
/ {
	marvell_cfgdata {
		marvell,caldata_00_txpwrlimit_5g_cfg_set_sub0 = /bits/ 8 <
0x01 0x00 0x06 0x00 0xf0 0x01 0x89 0x01
0x3a 0x00 0x88 0x13 0x14 0x24 0x00 0x11 0x01 0x0d 0x02 0x0d 0x03 0x0d 0x04 0x0c
0x05 0x0c 0x06 0x0c 0x07 0x0a 0x08 0x0a 0x09 0x0a 0x0a 0x0c 0x0b 0x0c 0x0c 0x0c
0x0d 0x0a 0x0e 0x0a 0x0f 0x0a 0x10 0x0b 0x11 0x09 0x12 0x08 0x13 0x08 0x14 0x08
0x15 0x08 0x16 0x0b 0x17 0x09 0x18 0x08 0x19 0x08 0x1a 0x08 0x89 0x01 0x3a 0x00
0x88 0x13 0x14 0x28 0x00 0x11 0x01 0x0d 0x02 0x0d 0x03 0x0d 0x04 0x0c 0x05 0x0c
0x06 0x0c 0x07 0x0a 0x08 0x0a 0x09 0x0a 0x0a 0x0c 0x0b 0x0c 0x0c 0x0c 0x0d 0x0a
0x0e 0x0a 0x0f 0x0a 0x10 0x0b 0x11 0x09 0x12 0x08 0x13 0x08 0x14 0x08 0x15 0x08
0x16 0x0b 0x17 0x09 0x18 0x08 0x19 0x08 0x1a 0x08 0x89 0x01 0x3a 0x00 0x88 0x13
0x14 0x2c 0x00 0x11 0x01 0x0d 0x02 0x0d 0x03 0x0d 0x04 0x0c 0x05 0x0c 0x06 0x0c
0x07 0x0a 0x08 0x0a 0x09 0x0a 0x0a 0x0c 0x0b 0x0c 0x0c 0x0c 0x0d 0x0a 0x0e 0x0a
0x0f 0x0a 0x10 0x0b 0x11 0x09 0x12 0x08 0x13 0x08 0x14 0x08 0x15 0x08 0x16 0x0b
0x17 0x09 0x18 0x08 0x19 0x08 0x1a 0x08 0x89 0x01 0x3a 0x00 0x88 0x13 0x14 0x30
0x00 0x11 0x01 0x0d 0x02 0x0d 0x03 0x0d 0x04 0x0c 0x05 0x0c 0x06 0x0c 0x07 0x0a
0x08 0x0a 0x09 0x0a 0x0a 0x0c 0x0b 0x0c 0x0c 0x0c 0x0d 0x0a 0x0e 0x0a 0x0f 0x0a
0x10 0x0b 0x11 0x09 0x12 0x08 0x13 0x08 0x14 0x08 0x15 0x08 0x16 0x0b 0x17 0x09
0x18 0x08 0x19 0x08 0x1a 0x08 0x89 0x01 0x3a 0x00 0x88 0x13 0x14 0x34 0x00 0x11
0x01 0x0d 0x02 0x0d 0x03 0x0d 0x04 0x0c 0x05 0x0c 0x06 0x0c 0x07 0x0a 0x08 0x0a
0x09 0x0a 0x0a 0x0c 0x0b 0x0c 0x0c 0x0c 0x0d 0x0a 0x0e 0x0a 0x0f 0x0a 0x10 0x0b
0x11 0x09 0x12 0x08 0x13 0x08 0x14 0x08 0x15 0x08 0x16 0x0b 0x17 0x09 0x18 0x08
0x19 0x08 0x1a 0x08 0x89 0x01 0x3a 0x00 0x88 0x13 0x14 0x38 0x00 0x11 0x01 0x0d
0x02 0x0d 0x03 0x0d 0x04 0x0c 0x05 0x0c 0x06 0x0c 0x07 0x0a 0x08 0x0a 0x09 0x0a
0x0a 0x0c 0x0b 0x0c 0x0c 0x0c 0x0d 0x0a 0x0e 0x0a 0x0f 0x0a 0x10 0x0b 0x11 0x09
0x12 0x08 0x13 0x08 0x14 0x08 0x15 0x08 0x16 0x0b 0x17 0x09 0x18 0x08 0x19 0x08
0x1a 0x08 0x89 0x01 0x3a 0x00 0x88 0x13 0x14 0x3c 0x00 0x11 0x01 0x0d 0x02 0x0d
0x03 0x0d 0x04 0x0c 0x05 0x0c 0x06 0x0c 0x07 0x0a 0x08 0x0a 0x09 0x0a 0x0a 0x0c
0x0b 0x0c 0x0c 0x0c 0x0d 0x0a 0x0e 0x0a 0x0f 0x0a 0x10 0x0b 0x11 0x09 0x12 0x08
0x13 0x08 0x14 0x08 0x15 0x08 0x16 0x0b 0x17 0x09 0x18 0x08 0x19 0x08 0x1a 0x08
0x89 0x01 0x3a 0x00 0x88 0x13 0x14 0x40 0x00 0x11 0x01 0x0d 0x02 0x0d 0x03 0x0d
0x04 0x0c 0x05 0x0c 0x06 0x0c 0x07 0x0a 0x08 0x0a 0x09 0x0a 0x0a 0x0c 0x0b 0x0c
0x0c 0x0c 0x0d 0x0a 0x0e 0x0a 0x0f 0x0a 0x10 0x0b 0x11 0x09 0x12 0x08 0x13 0x08
0x14 0x08 0x15 0x08 0x16 0x0b 0x17 0x09 0x18 0x08 0x19 0x08 0x1a 0x08
		>;
	};
};
/ {
	marvell_cfgdata {
		marvell,caldata_00_txpwrlimit_5g_cfg_set_sub1 = /bits/ 8 <
0x01 0x00 0x06 0x00 0xaa 0x02 0x89 0x01
0x3a 0x00 0x88 0x13 0x14 0x64 0x00 0x11 0x01 0x0d 0x02 0x0d 0x03 0x0d 0x04 0x0c
0x05 0x0c 0x06 0x0c 0x07 0x0a 0x08 0x0a 0x09 0x0a 0x0a 0x0c 0x0b 0x0c 0x0c 0x0c
0x0d 0x0a 0x0e 0x0a 0x0f 0x0a 0x10 0x0b 0x11 0x09 0x12 0x08 0x13 0x08 0x14 0x08
0x15 0x08 0x16 0x0b 0x17 0x09 0x18 0x08 0x19 0x08 0x1a 0x08 0x89 0x01 0x3a 0x00
0x88 0x13 0x14 0x68 0x00 0x11 0x01 0x0d 0x02 0x0d 0x03 0x0d 0x04 0x0c 0x05 0x0c
0x06 0x0c 0x07 0x0a 0x08 0x0a 0x09 0x0a 0x0a 0x0c 0x0b 0x0c 0x0c 0x0c 0x0d 0x0a
0x0e 0x0a 0x0f 0x0a 0x10 0x0b 0x11 0x09 0x12 0x08 0x13 0x08 0x14 0x08 0x15 0x08
0x16 0x0b 0x17 0x09 0x18 0x08 0x19 0x08 0x1a 0x08 0x89 0x01 0x3a 0x00 0x88 0x13
0x14 0x6c 0x00 0x11 0x01 0x0d 0x02 0x0d 0x03 0x0d 0x04 0x0c 0x05 0x0c 0x06 0x0c
0x07 0x0a 0x08 0x0a 0x09 0x0a 0x0a 0x0c 0x0b 0x0c 0x0c 0x0c 0x0d 0x0a 0x0e 0x0a
0x0f 0x0a 0x10 0x0b 0x11 0x09 0x12 0x08 0x13 0x08 0x14 0x08 0x15 0x08 0x16 0x0b
0x17 0x09 0x18 0x08 0x19 0x08 0x1a 0x08 0x89 0x01 0x3a 0x00 0x88 0x13 0x14 0x70
0x00 0x11 0x01 0x0d 0x02 0x0d 0x03 0x0d 0x04 0x0c 0x05 0x0c 0x06 0x0c 0x07 0x0a
0x08 0x0a 0x09 0x0a 0x0a 0x0c 0x0b 0x0c 0x0c 0x0c 0x0d 0x0a 0x0e 0x0a 0x0f 0x0a
0x10 0x0b 0x11 0x09 0x12 0x08 0x13 0x08 0x14 0x08 0x15 0x08 0x16 0x0b 0x17 0x09
0x18 0x08 0x19 0x08 0x1a 0x08 0x89 0x01 0x3a 0x00 0x88 0x13 0x14 0x74 0x00 0x11
0x01 0x0d 0x02 0x0d 0x03 0x0d 0x04 0x0c 0x05 0x0c 0x06 0x0c 0x07 0x0a 0x08 0x0a
0x09 0x0a 0x0a 0x0c 0x0b 0x0c 0x0c 0x0c 0x0d 0x0a 0x0e 0x0a 0x0f 0x0a 0x10 0x0b
0x11 0x09 0x12 0x08 0x13 0x08 0x14 0x08 0x15 0x08 0x16 0x0b 0x17 0x09 0x18 0x08
0x19 0x08 0x1a 0x08 0x89 0x01 0x3a 0x00 0x88 0x13 0x14 0x78 0x00 0x11 0x01 0x0d
0x02 0x0d 0x03 0x0d 0x04 0x0c 0x05 0x0c 0x06 0x0c 0x07 0x0a 0x08 0x0a 0x09 0x0a
0x0a 0x0c 0x0b 0x0c 0x0c 0x0c 0x0d 0x0a 0x0e 0x0a 0x0f 0x0a 0x10 0x0b 0x11 0x09
0x12 0x08 0x13 0x08 0x14 0x08 0x15 0x08 0x16 0x0b 0x17 0x09 0x18 0x08 0x19 0x08
0x1a 0x08 0x89 0x01 0x3a 0x00 0x88 0x13 0x14 0x7c 0x00 0x11 0x01 0x0d 0x02 0x0d
0x03 0x0d 0x04 0x0c 0x05 0x0c 0x06 0x0c 0x07 0x0a 0x08 0x0a 0x09 0x0a 0x0a 0x0c
0x0b 0x0c 0x0c 0x0c 0x0d 0x0a 0x0e 0x0a 0x0f 0x0a 0x10 0x0b 0x11 0x09 0x12 0x08
0x13 0x08 0x14 0x08 0x15 0x08 0x16 0x0b 0x17 0x09 0x18 0x08 0x19 0x08 0x1a 0x08
0x89 0x01 0x3a 0x00 0x88 0x13 0x14 0x80 0x00 0x11 0x01 0x0d 0x02 0x0d 0x03 0x0d
0x04 0x0c 0x05 0x0c 0x06 0x0c 0x07 0x0a 0x08 0x0a 0x09 0x0a 0x0a 0x0c 0x0b 0x0c
0x0c 0x0c 0x0d 0x0a 0x0e 0x0a 0x0f 0x0a 0x10 0x0b 0x11 0x09 0x12 0x08 0x13 0x08
0x14 0x08 0x15 0x08 0x16 0x0b 0x17 0x09 0x18 0x08 0x19 0x08 0x1a 0x08 0x89 0x01
0x3a 0x00 0x88 0x13 0x14 0x84 0x00 0x11 0x01 0x0d 0x02 0x0d 0x03 0x0d 0x04 0x0c
0x05 0x0c 0x06 0x0c 0x07 0x0a 0x08 0x0a 0x09 0x0a 0x0a 0x0c 0x0b 0x0c 0x0c 0x0c
0x0d 0x0a 0x0e 0x0a 0x0f 0x0a 0x10 0x0b 0x11 0x09 0x12 0x08 0x13 0x08 0x14 0x08
0x15 0x08 0x16 0x0b 0x17 0x09 0x18 0x08 0x19 0x08 0x1a 0x08 0x89 0x01 0x3a 0x00
0x88 0x13 0x14 0x88 0x00 0x11 0x01 0x0d 0x02 0x0d 0x03 0x0d 0x04 0x0c 0x05 0x0c
0x06 0x0c 0x07 0x0a 0x08 0x0a 0x09 0x0a 0x0a 0x0c 0x0b 0x0c 0x0c 0x0c 0x0d 0x0a
0x0e 0x0a 0x0f 0x0a 0x10 0x0b 0x11 0x09 0x12 0x08 0x13 0x08 0x14 0x08 0x15 0x08
0x16 0x0b 0x17 0x09 0x18 0x08 0x19 0x08 0x1a 0x08 0x89 0x01 0x3a 0x00 0x88 0x13
0x14 0x8c 0x00 0x11 0x01 0x0d 0x02 0x0d 0x03 0x0d 0x04 0x0c 0x05 0x0c 0x06 0x0c
0x07 0x0a 0x08 0x0a 0x09 0x0a 0x0a 0x0c 0x0b 0x0c 0x0c 0x0c 0x0d 0x0a 0x0e 0x0a
0x0f 0x0a 0x10 0x0b 0x11 0x09 0x12 0x08 0x13 0x08 0x14 0x08 0x15 0x08 0x16 0x0b
0x17 0x09 0x18 0x08 0x19 0x08 0x1a 0x08
		>;
	};
};
/ {
	marvell_cfgdata {
		marvell,caldata_00_txpwrlimit_5g_cfg_set_sub2 = /bits/ 8 <
0x01 0x00 0x06 0x00 0xe8 0x02 0x89 0x01
0x3a 0x00 0x88 0x13 0x14 0x95 0x00 0x11 0x01 0x0d 0x02 0x0d 0x03 0x0d 0x04 0x0c
0x05 0x0c 0x06 0x0c 0x07 0x0a 0x08 0x0a 0x09 0x0a 0x0a 0x0c 0x0b 0x0c 0x0c 0x0c
0x0d 0x0a 0x0e 0x0a 0x0f 0x0a 0x10 0x0b 0x11 0x09 0x12 0x08 0x13 0x08 0x14 0x08
0x15 0x08 0x16 0x0b 0x17 0x09 0x18 0x08 0x19 0x08 0x1a 0x08 0x89 0x01 0x3a 0x00
0x88 0x13 0x14 0x99 0x00 0x11 0x01 0x0d 0x02 0x0d 0x03 0x0d 0x04 0x0c 0x05 0x0c
0x06 0x0c 0x07 0x0a 0x08 0x0a 0x09 0x0a 0x0a 0x0c 0x0b 0x0c 0x0c 0x0c 0x0d 0x0a
0x0e 0x0a 0x0f 0x0a 0x10 0x0b 0x11 0x09 0x12 0x08 0x13 0x08 0x14 0x08 0x15 0x08
0x16 0x0b 0x17 0x09 0x18 0x08 0x19 0x08 0x1a 0x08 0x89 0x01 0x3a 0x00 0x88 0x13
0x14 0x9d 0x00 0x11 0x01 0x0d 0x02 0x0d 0x03 0x0d 0x04 0x0c 0x05 0x0c 0x06 0x0c
0x07 0x0a 0x08 0x0a 0x09 0x0a 0x0a 0x0c 0x0b 0x0c 0x0c 0x0c 0x0d 0x0a 0x0e 0x0a
0x0f 0x0a 0x10 0x0b 0x11 0x09 0x12 0x08 0x13 0x08 0x14 0x08 0x15 0x08 0x16 0x0b
0x17 0x09 0x18 0x08 0x19 0x08 0x1a 0x08 0x89 0x01 0x3a 0x00 0x88 0x13 0x14 0xa1
0x00 0x11 0x01 0x0d 0x02 0x0d 0x03 0x0d 0x04 0x0c 0x05 0x0c 0x06 0x0c 0x07 0x0a
0x08 0x0a 0x09 0x0a 0x0a 0x0c 0x0b 0x0c 0x0c 0x0c 0x0d 0x0a 0x0e 0x0a 0x0f 0x0a
0x10 0x0b 0x11 0x09 0x12 0x08 0x13 0x08 0x14 0x08 0x15 0x08 0x16 0x0b 0x17 0x09
0x18 0x08 0x19 0x08 0x1a 0x08 0x89 0x01 0x3a 0x00 0x88 0x13 0x14 0xa5 0x00 0x11
0x01 0x0d 0x02 0x0d 0x03 0x0d 0x04 0x0c 0x05 0x0c 0x06 0x0c 0x07 0x0a 0x08 0x0a
0x09 0x0a 0x0a 0x0c 0x0b 0x0c 0x0c 0x0c 0x0d 0x0a 0x0e 0x0a 0x0f 0x0a 0x10 0x0b
0x11 0x09 0x12 0x08 0x13 0x08 0x14 0x08 0x15 0x08 0x16 0x0b 0x17 0x09 0x18 0x08
0x19 0x08 0x1a 0x08 0x89 0x01 0x3a 0x00 0x88 0x13 0x14 0xb7 0x00 0x11 0x01 0x0c
0x02 0x0c 0x03 0x0c 0x04 0x0f 0x05 0x0d 0x06 0x0d 0x07 0x0f 0x08 0x0d 0x09 0x0d
0x0a 0x0f 0x0b 0x0d 0x0c 0x0d 0x0d 0x0f 0x0e 0x0d 0x0f 0x0b 0x10 0x0a 0x11 0x0a
0x12 0x0d 0x13 0x0a 0x14 0x0a 0x15 0x0a 0x16 0x0a 0x17 0x0a 0x18 0x0d 0x19 0x0a
0x1a 0x0a 0x89 0x01 0x3a 0x00 0x88 0x13 0x14 0xb8 0x00 0x11 0x01 0x0c 0x02 0x0c
0x03 0x0c 0x04 0x0f 0x05 0x0d 0x06 0x0d 0x07 0x0f 0x08 0x0d 0x09 0x0d 0x0a 0x0f
0x0b 0x0d 0x0c 0x0d 0x0d 0x0f 0x0e 0x0d 0x0f 0x0b 0x10 0x0a 0x11 0x0a 0x12 0x0d
0x13 0x0a 0x14 0x0a 0x15 0x0a 0x16 0x0a 0x17 0x0a 0x18 0x0d 0x19 0x0a 0x1a 0x0a
0x89 0x01 0x3a 0x00 0x88 0x13 0x14 0xb9 0x00 0x11 0x01 0x0c 0x02 0x0c 0x03 0x0c
0x04 0x0f 0x05 0x0d 0x06 0x0d 0x07 0x0f 0x08 0x0d 0x09 0x0d 0x0a 0x0f 0x0b 0x0d
0x0c 0x0d 0x0d 0x0f 0x0e 0x0d 0x0f 0x0b 0x10 0x0a 0x11 0x0a 0x12 0x0d 0x13 0x0a
0x14 0x0a 0x15 0x0a 0x16 0x0a 0x17 0x0a 0x18 0x0d 0x19 0x0a 0x1a 0x0a 0x89 0x01
0x3a 0x00 0x88 0x13 0x14 0xbb 0x00 0x11 0x01 0x0c 0x02 0x0c 0x03 0x0c 0x04 0x0f
0x05 0x0d 0x06 0x0d 0x07 0x0f 0x08 0x0d 0x09 0x0d 0x0a 0x0f 0x0b 0x0d 0x0c 0x0d
0x0d 0x0f 0x0e 0x0d 0x0f 0x0b 0x10 0x0a 0x11 0x0a 0x12 0x0d 0x13 0x0a 0x14 0x0a
0x15 0x0a 0x16 0x0a 0x17 0x0a 0x18 0x0d 0x19 0x0a 0x1a 0x0a 0x89 0x01 0x3a 0x00
0x88 0x13 0x14 0xbc 0x00 0x11 0x01 0x0c 0x02 0x0c 0x03 0x0c 0x04 0x0f 0x05 0x0d
0x06 0x0d 0x07 0x0f 0x08 0x0d 0x09 0x0d 0x0a 0x0f 0x0b 0x0d 0x0c 0x0d 0x0d 0x0f
0x0e 0x0d 0x0f 0x0b 0x10 0x0a 0x11 0x0a 0x12 0x0d 0x13 0x0a 0x14 0x0a 0x15 0x0a
0x16 0x0a 0x17 0x0a 0x18 0x0d 0x19 0x0a 0x1a 0x0a 0x89 0x01 0x3a 0x00 0x88 0x13
0x14 0xbd 0x00 0x11 0x01 0x0c 0x02 0x0c 0x03 0x0c 0x04 0x0f 0x05 0x0d 0x06 0x0d
0x07 0x0f 0x08 0x0d 0x09 0x0d 0x0a 0x0f 0x0b 0x0d 0x0c 0x0d 0x0d 0x0f 0x0e 0x0d
0x0f 0x0b 0x10 0x0a 0x11 0x0a 0x12 0x0d 0x13 0x0a 0x14 0x0a 0x15 0x0a 0x16 0x0a
0x17 0x0a 0x18 0x0d 0x19 0x0a 0x1a 0x0a 0x89 0x01 0x3a 0x00 0x88 0x13 0x14 0xc0
0x00 0x11 0x01 0x0c 0x02 0x0c 0x03 0x0c 0x04 0x0f 0x05 0x0d 0x06 0x0d 0x07 0x0f
0x08 0x0d 0x09 0x0d 0x0a 0x0f 0x0b 0x0d 0x0c 0x0d 0x0d 0x0f 0x0e 0x0d 0x0f 0x0b
0x10 0x0a 0x11 0x0a 0x12 0x0d 0x13 0x0a 0x14 0x0a 0x15 0x0a 0x16 0x0a 0x17 0x0a
0x18 0x0d 0x19 0x0a 0x1a 0x0a
		>;
	};
};
/ {
	marvell_cfgdata {
		marvell,caldata_00_txpwrlimit_5g_cfg_set_sub3 = /bits/ 8 <
0x01 0x00 0x06 0x00 0xf0 0x01 0x89 0x01
0x3a 0x00 0x88 0x13 0x14 0xc4 0x00 0x11 0x01 0x0c 0x02 0x0c 0x03 0x0c 0x04 0x0f
0x05 0x0d 0x06 0x0d 0x07 0x0f 0x08 0x0d 0x09 0x0d 0x0a 0x0f 0x0b 0x0d 0x0c 0x0d
0x0d 0x0f 0x0e 0x0d 0x0f 0x0b 0x10 0x0a 0x11 0x0a 0x12 0x0d 0x13 0x0a 0x14 0x0a
0x15 0x0a 0x16 0x0a 0x17 0x0a 0x18 0x0d 0x19 0x0a 0x1a 0x0a 0x89 0x01 0x3a 0x00
0x88 0x13 0x14 0x07 0x00 0x11 0x01 0x0c 0x02 0x0c 0x03 0x0c 0x04 0x0f 0x05 0x0d
0x06 0x0d 0x07 0x0f 0x08 0x0d 0x09 0x0d 0x0a 0x0f 0x0b 0x0d 0x0c 0x0d 0x0d 0x0f
0x0e 0x0d 0x0f 0x0b 0x10 0x0a 0x11 0x0a 0x12 0x0d 0x13 0x0a 0x14 0x0a 0x15 0x0a
0x16 0x0a 0x17 0x0a 0x18 0x0d 0x19 0x0a 0x1a 0x0a 0x89 0x01 0x3a 0x00 0x88 0x13
0x14 0x08 0x00 0x11 0x01 0x0c 0x02 0x0c 0x03 0x0c 0x04 0x0f 0x05 0x0d 0x06 0x0d
0x07 0x0f 0x08 0x0d 0x09 0x0d 0x0a 0x0f 0x0b 0x0d 0x0c 0x0d 0x0d 0x0f 0x0e 0x0d
0x0f 0x0b 0x10 0x0a 0x11 0x0a 0x12 0x0d 0x13 0x0a 0x14 0x0a 0x15 0x0a 0x16 0x0a
0x17 0x0a 0x18 0x0d 0x19 0x0a 0x1a 0x0a 0x89 0x01 0x3a 0x00 0x88 0x13 0x14 0x0b
0x00 0x11 0x01 0x0c 0x02 0x0c 0x03 0x0c 0x04 0x0f 0x05 0x0d 0x06 0x0d 0x07 0x0f
0x08 0x0d 0x09 0x0d 0x0a 0x0f 0x0b 0x0d 0x0c 0x0d 0x0d 0x0f 0x0e 0x0d 0x0f 0x0b
0x10 0x0a 0x11 0x0a 0x12 0x0d 0x13 0x0a 0x14 0x0a 0x15 0x0a 0x16 0x0a 0x17 0x0a
0x18 0x0d 0x19 0x0a 0x1a 0x0a 0x89 0x01 0x3a 0x00 0x88 0x13 0x14 0x0c 0x00 0x11
0x01 0x0c 0x02 0x0c 0x03 0x0c 0x04 0x0f 0x05 0x0d 0x06 0x0d 0x07 0x0f 0x08 0x0d
0x09 0x0d 0x0a 0x0f 0x0b 0x0d 0x0c 0x0d 0x0d 0x0f 0x0e 0x0d 0x0f 0x0b 0x10 0x0a
0x11 0x0a 0x12 0x0d 0x13 0x0a 0x14 0x0a 0x15 0x0a 0x16 0x0a 0x17 0x0a 0x18 0x0d
0x19 0x0a 0x1a 0x0a 0x89 0x01 0x3a 0x00 0x88 0x13 0x14 0x10 0x00 0x11 0x01 0x0c
0x02 0x0c 0x03 0x0c 0x04 0x0f 0x05 0x0d 0x06 0x0d 0x07 0x0f 0x08 0x0d 0x09 0x0d
0x0a 0x0f 0x0b 0x0d 0x0c 0x0d 0x0d 0x0f 0x0e 0x0d 0x0f 0x0b 0x10 0x0a 0x11 0x0a
0x12 0x0d 0x13 0x0a 0x14 0x0a 0x15 0x0a 0x16 0x0a 0x17 0x0a 0x18 0x0d 0x19 0x0a
0x1a 0x0a 0x89 0x01 0x3a 0x00 0x88 0x13 0x14 0x22 0x00 0x11 0x01 0x0c 0x02 0x0c
0x03 0x0c 0x04 0x0f 0x05 0x0d 0x06 0x0d 0x07 0x0f 0x08 0x0d 0x09 0x0d 0x0a 0x0f
0x0b 0x0d 0x0c 0x0d 0x0d 0x0f 0x0e 0x0d 0x0f 0x0b 0x10 0x0a 0x11 0x0a 0x12 0x0d
0x13 0x0a 0x14 0x0a 0x15 0x0a 0x16 0x0a 0x17 0x0a 0x18 0x0d 0x19 0x0a 0x1a 0x0a
0x89 0x01 0x3a 0x00 0x88 0x13 0x14 0x90 0x00 0x11 0x01 0x0d 0x02 0x0d 0x03 0x0d
0x04 0x0c 0x05 0x0c 0x06 0x0c 0x07 0x0a 0x08 0x0a 0x09 0x0a 0x0a 0x0c 0x0b 0x0c
0x0c 0x0c 0x0d 0x0a 0x0e 0x0a 0x0f 0x0a 0x10 0x08 0x11 0x08 0x12 0x06 0x13 0x06
0x14 0x06 0x15 0x06 0x16 0x08 0x17 0x08 0x18 0x06 0x19 0x06 0x1a 0x06
		>;
	};
};
